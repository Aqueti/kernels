# 1 "arch/arm64/boot/dts/tegra210-grenada.dts"
# 1 "<built-in>"
# 1 "<command-line>"
# 1 "arch/arm64/boot/dts/tegra210-grenada.dts"
# 21 "arch/arm64/boot/dts/tegra210-grenada.dts"
/dts-v1/;

/memreserve/ 0x80000000 0x00020000;

# 1 "arch/arm64/boot/dts/tegra210-soc-shield.dtsi" 1
# 16 "arch/arm64/boot/dts/tegra210-soc-shield.dtsi"
# 1 "arch/arm64/boot/dts/tegra210-soc-base.dtsi" 1
# 16 "arch/arm64/boot/dts/tegra210-soc-base.dtsi"
# 1 "/home/mosaic/kernel/JetPack_5.26.16b/TX1/Linux_for_Tegra_tx1/sources/kernel_source/arch/arm64/boot/dts/include/dt-bindings/interrupt-controller/arm-gic.h" 1







# 1 "/home/mosaic/kernel/JetPack_5.26.16b/TX1/Linux_for_Tegra_tx1/sources/kernel_source/arch/arm64/boot/dts/include/dt-bindings/interrupt-controller/irq.h" 1
# 9 "/home/mosaic/kernel/JetPack_5.26.16b/TX1/Linux_for_Tegra_tx1/sources/kernel_source/arch/arm64/boot/dts/include/dt-bindings/interrupt-controller/arm-gic.h" 2
# 17 "arch/arm64/boot/dts/tegra210-soc-base.dtsi" 2
# 1 "/home/mosaic/kernel/JetPack_5.26.16b/TX1/Linux_for_Tegra_tx1/sources/kernel_source/arch/arm64/boot/dts/include/dt-bindings/memory/tegra-swgroup.h" 1
# 18 "arch/arm64/boot/dts/tegra210-soc-base.dtsi" 2
# 1 "arch/arm64/boot/dts/tegra210-platforms/tegra210-thermal.dtsi" 1
# 19 "arch/arm64/boot/dts/tegra210-platforms/tegra210-thermal.dtsi"
# 1 "/home/mosaic/kernel/JetPack_5.26.16b/TX1/Linux_for_Tegra_tx1/sources/kernel_source/arch/arm64/boot/dts/include/dt-bindings/thermal/thermal.h" 1
# 20 "arch/arm64/boot/dts/tegra210-platforms/tegra210-thermal.dtsi" 2

/ {
 thermal-zones {
  AO-therm {
   status = "disabled";
   polling-delay = <0>;
   polling-delay-passive = <1000>;
   thermal-sensors = <&{/tegra-aotag}>;



   trips {
    trip_shutdown {
     temperature = <110000>;
     hysteresis = <0>;
     type = "critical";
     writable;
    };
   };
  };
  CPU-therm {
   polling-delay = <0>;
   polling-delay-passive = <1000>;
   thermal-sensors = <&{/soctherm@0x700E2000} 0>;
   status = "disabled";
  };
  GPU-therm {
   polling-delay = <0>;
   polling-delay-passive = <1000>;
   thermal-sensors = <&{/soctherm@0x700E2000} 1>;
   status = "disabled";
  };
  LCPU-therm {
   polling-delay = <0>;
   polling-delay-passive = <1000>;
   thermal-sensors = <&{/soctherm@0x700E2000} 2>;
   status = "disabled";
  };
  PLL-therm {
   polling-delay = <0>;
   polling-delay-passive = <1000>;
   thermal-sensors = <&{/soctherm@0x700E2000} 3>;
   status = "disabled";
  };
 };
};
# 19 "arch/arm64/boot/dts/tegra210-soc-base.dtsi" 2
# 1 "/home/mosaic/kernel/JetPack_5.26.16b/TX1/Linux_for_Tegra_tx1/sources/kernel_source/arch/arm64/boot/dts/include/dt-bindings/gpio/tegra-gpio.h" 1
# 13 "/home/mosaic/kernel/JetPack_5.26.16b/TX1/Linux_for_Tegra_tx1/sources/kernel_source/arch/arm64/boot/dts/include/dt-bindings/gpio/tegra-gpio.h"
# 1 "/home/mosaic/kernel/JetPack_5.26.16b/TX1/Linux_for_Tegra_tx1/sources/kernel_source/arch/arm64/boot/dts/include/dt-bindings/gpio/gpio.h" 1
# 14 "/home/mosaic/kernel/JetPack_5.26.16b/TX1/Linux_for_Tegra_tx1/sources/kernel_source/arch/arm64/boot/dts/include/dt-bindings/gpio/tegra-gpio.h" 2
# 20 "arch/arm64/boot/dts/tegra210-soc-base.dtsi" 2
# 1 "/home/mosaic/kernel/JetPack_5.26.16b/TX1/Linux_for_Tegra_tx1/sources/kernel_source/arch/arm64/boot/dts/include/dt-bindings/padctrl/tegra210-pads.h" 1
# 21 "arch/arm64/boot/dts/tegra210-soc-base.dtsi" 2
# 1 "/home/mosaic/kernel/JetPack_5.26.16b/TX1/Linux_for_Tegra_tx1/sources/kernel_source/arch/arm64/boot/dts/include/dt-bindings/ata/ahci-tegra.h" 1
# 22 "arch/arm64/boot/dts/tegra210-soc-base.dtsi" 2
# 1 "/home/mosaic/kernel/JetPack_5.26.16b/TX1/Linux_for_Tegra_tx1/sources/kernel_source/arch/arm64/boot/dts/include/dt-bindings/clk/tegra210-clk.h" 1
# 23 "arch/arm64/boot/dts/tegra210-soc-base.dtsi" 2
# 1 "/home/mosaic/kernel/JetPack_5.26.16b/TX1/Linux_for_Tegra_tx1/sources/kernel_source/arch/arm64/boot/dts/include/dt-bindings/soc/nvidia,tegra210-powergate.h" 1
# 24 "arch/arm64/boot/dts/tegra210-soc-base.dtsi" 2

/ {
 compatible = "nvidia,tegra210";
 interrupt-parent = <&intc>;
 #address-cells = <2>;
 #size-cells = <2>;

 cpus {
  #address-cells = <2>;
  #size-cells = <0>;
  status = "disabled";

  cpu@0 {
   device_type = "cpu";
   compatible = "arm,cortex-a57-64bit", "arm,armv8";
   reg = <0x0 0x0>;
   enable-method = "psci";
   errata_hwcaps = <0x7>;
   status = "disabled";
  };

  cpu@1 {
   device_type = "cpu";
   compatible = "arm,cortex-a57-64bit", "arm,armv8";
   reg = <0x0 0x1>;
   enable-method = "psci";
   errata_hwcaps = <0x7>;
   status = "disabled";
  };

  cpu@2 {
   device_type = "cpu";
   compatible = "arm,cortex-a57-64bit", "arm,armv8";
   reg = <0x0 0x2>;
   enable-method = "psci";
   errata_hwcaps = <0x7>;
   status = "disabled";
  };

  cpu@3 {
   device_type = "cpu";
   compatible = "arm,cortex-a57-64bit", "arm,armv8";
   reg = <0x0 0x3>;
   enable-method = "psci";
   errata_hwcaps = <0x7>;
   status = "disabled";
  };
 };

 mc_clk_pd: mc-clk-pd {
  compatible = "nvidia,tegra210-mc-clk-pd";
  #power-domain-cells = <0>;
 };

 ape_pd: ape-pd {
  compatible = "nvidia,tegra210-ape-pd";
  #power-domain-cells = <0>;
  power-domains = <&mc_clk_pd>;
  partition-id = <27>;
 };

 adsp_pd: adsp-pd {
  compatible = "nvidia,tegra210-adsp-pd";
  #power-domain-cells = <0>;
  power-domains = <&ape_pd>;
 };

 host1x_pd: host1x-pd {
  compatible = "nvidia,tegra210-host1x-pd";
  is_off;
  host1x;
  #power-domain-cells = <0>;
  power-domains = <&mc_clk_pd>;
 };

 tsec_pd: tsec-pd {
  compatible = "nvidia,tegra210-tsec-pd";
  is_off;
  #power-domain-cells = <0>;
  power-domains = <&host1x_pd>;
 };

 nvdec_pd: nvdec-pd {
  compatible = "nvidia,tegra210-nvdec-pd";
  is_off;
  #power-domain-cells = <0>;
  power-domains = <&host1x_pd>;
  partition-id = <25>;
 };

 ve_pd: ve-pd {
  compatible = "nvidia,tegra210-ve-pd";
  is_off;
  #power-domain-cells = <0>;
  power-domains = <&host1x_pd>;
  partition-id = <2>;
 };

 ve2_pd: ve2-pd {
                compatible = "nvidia,tegra210-ve2-pd";
  is_off;
                #power-domain-cells = <0>;
                power-domains = <&host1x_pd>;
  partition-id = <29>;
        };

 vic03_pd: vic03-pd {
  compatible = "nvidia,tegra210-vic03-pd";
  is_off;
  #power-domain-cells = <0>;
  power-domains = <&host1x_pd>;
  partition-id = <23>;
 };

 msenc_pd: msenc-pd {
  compatible = "nvidia,tegra210-msenc-pd";
  is_off;
  #power-domain-cells = <0>;
                power-domains = <&host1x_pd>;
  partition-id = <6>;
 };

 nvjpg_pd: nvjpg-pd {
  compatible = "nvidia,tegra210-nvjpg-pd";
  is_off;
  #power-domain-cells = <0>;
                power-domains = <&host1x_pd>;
  partition-id = <26>;
 };

 gpu_pd: gpu-pd {
  compatible = "nvidia,tegra210-gpu-pd";
  is_off;
  #power-domain-cells = <0>;
                power-domains = <&host1x_pd>;
  partition-id = <1>;
 };

 pcie_pd: pcie-pd {
  compatible = "nvidia, tegra210-pcie-pd";
  #power-domain-cells = <0>;
  partition-id = <3>;
 };

 sata_pd: sata-pd {
  compatible = "nvidia, tegra210-sata-pd";
  #power-domain-cells = <0>;
  partition-id = <8>;
 };

 sor_pd: sor-pd {
  compatible = "nvidia, tegra210-sor-pd";
  #power-domain-cells = <0>;
  partition-id = <17>;
 };

 disa_pd: disa-pd {
  compatible = "nvidia, tegra210-disa-pd";
  #power-domain-cells = <0>;
  partition-id = <18>;
 };

 disb_pd: disb-pd {
  compatible = "nvidia, tegra210-disb-pd";
  #power-domain-cells = <0>;
  partition-id = <19>;
 };

 xusba_pd: xusba-pd {
  compatible = "nvidia, tegra210-xusba-pd";
  #power-domain-cells = <0>;
  partition-id = <20>;
 };

 xusbb_pd: xusbb-pd {
  compatible = "nvidia, tegra210-xusbb-pd";
  #power-domain-cells = <0>;
  partition-id = <21>;
 };

 xusbc_pd: xusbc-pd {
  compatible = "nvidia, tegra210-xusbc-pd";
  #power-domain-cells = <0>;
  partition-id = <22>;
 };

 psci {
  compatible = "arm,psci-0.2";
  status = "disabled";
  method = "smc";
 };

 tlk {
  compatible = "nvidia,trusted-little-kernel";
  logger = "enabled";
  storage = "enabled";
 };

 arm-pmu {
  compatible = "arm,armv8-pmuv3";
  status = "disabled";
  interrupts = <0 144 0x4>,
        <0 145 0x4>,
        <0 146 0x4>,
        <0 147 0x4>;
 };

 tegra_car: clock {
  compatible = "nvidia,tegra210-car";
  reg = <0x0 0x60006000 0x0 0x1000>;
  #clock-cells = <1>;
  #reset-cells = <1>;
  status = "disabled";
 };

 reserved-memory {
  #address-cells = <2>;
  #size-cells = <2>;
  ranges;

  iram: iram-carveout {
   compatible = "nvidia,iram-carveout";
   reg = <0x0 0x40001000 0x0 0x3F000>;
   no-map;
  };
 };

 tegra-carveouts {
  compatible = "nvidia,carveouts";
  iommus = <&smmu 6>,
    <&smmu 1>;
  memory-region = <&iram>;
  status = "okay";
 };

 smmu: iommu {
  compatible = "nvidia,tegra210-smmu";
  reg = <0x0 0x70019000 0x0 0x1000
         0x0 0x6000c000 0x0 0x1000>;
  status = "disabled";
  #asids = <128>;
  dma-window = <0x0 0x80000000 0x0 0x7ff00000>;
  #iommu-cells = <1>;
  swgid-mask = <0x00000fff 0xfffccdcf>;
  #num-translation-enable = <5>;
  #num-asid-security = <8>;

  domains = <&ppcs_as (((1ULL << 14) | (1ULL << 24) | (1ULL << 32) | (1ULL << 35) | (1ULL << 38)) & 0xffffffff) (((1ULL << 14) | (1ULL << 24) | (1ULL << 32) | (1ULL << 35) | (1ULL << 38)) >> 32)
      &gpu_as (((1ULL << 31)) & 0xffffffff) (((1ULL << 31)) >> 32)
      &ape_as (((1ULL << 34)) & 0xffffffff) (((1ULL << 34)) >> 32)
      &dc_as (((1ULL << 2) | (1ULL << 10)) & 0xffffffff) (((1ULL << 2) | (1ULL << 10)) >> 32)
      &dc_as (((1ULL << 3)) & 0xffffffff) (((1ULL << 3)) >> 32)
      &common_as (((1ULL << 0)) & 0xffffffff) (((1ULL << 0)) >> 32)
      &common_as (((1ULL << 25)) & 0xffffffff) (((1ULL << 25)) >> 32)
      &common_as (((1ULL << 26)) & 0xffffffff) (((1ULL << 26)) >> 32)
      &common_as (((1ULL << 27)) & 0xffffffff) (((1ULL << 27)) >> 32)
      &common_as (((1ULL << 28)) & 0xffffffff) (((1ULL << 28)) >> 32)
      &common_as (((1ULL << 6)) & 0xffffffff) (((1ULL << 6)) >> 32)
      &common_as 0xFFFFFFFF 0xFFFFFFFF>;

  address-space-prop {
   common_as: common {
    iova-start = <0x0 0x80000000>;
    iova-size = <0x0 0x7FF00000>;
    num-pf-page = <0>;
    gap-page = <1>;
   };
   ppcs_as: ppcs {
    iova-start = <0x0 0x80000000>;
    iova-size = <0x0 0x7FF00000>;
    num-pf-page = <1>;
    gap-page = <1>;
   };
   dc_as: dc {
    iova-start = <0x0 0x00010000>;
    iova-size = <0x0 0xFFFEFFFF>;
    num-pf-page = <0>;
    gap-page = <0>;
   };
   gpu_as: gpu {
    iova-start = <0x0 0x00100000>;
    iova-size = <0x3 0xFFEFFFFF>;
    alignment = <0x20000>;
    num-pf-page = <0>;
    gap-page = <0>;
   };
   ape_as: ape {
    iova-start = <0x0 0x70300000>;
    iova-size = <0x0 0x8FC00000>;
    num-pf-page = <0>;
    gap-page = <1>;
   };
  };
 };

 bpmp {
  compatible = "nvidia,tegra210-bpmp";
  carveout-start = <0x80005000>;
  carveout-size = <0x10000>;
  status = "disabled";
 };

 mc {
  compatible = "nvidia,tegra-mc";

  reg-ranges = <10>;
  reg = <0x0 0x70019000 0x0 0x00c>,
        <0x0 0x70019050 0x0 0x19c>,
        <0x0 0x70019200 0x0 0x024>,
        <0x0 0x7001929c 0x0 0x1b8>,
        <0x0 0x70019464 0x0 0x198>,
        <0x0 0x70019604 0x0 0x3b0>,
        <0x0 0x700199bc 0x0 0x020>,
        <0x0 0x700199f8 0x0 0x08c>,
        <0x0 0x70019ae4 0x0 0x0b0>,
        <0x0 0x70019ba0 0x0 0x460>,


        <0x0 0x7001c000 0x0 0x00c>,
        <0x0 0x7001c050 0x0 0x198>,
        <0x0 0x7001c200 0x0 0x024>,
        <0x0 0x7001c29c 0x0 0x1b8>,
        <0x0 0x7001c464 0x0 0x198>,
        <0x0 0x7001c604 0x0 0x3b0>,
        <0x0 0x7001c9bc 0x0 0x020>,
        <0x0 0x7001c9f8 0x0 0x08c>,
        <0x0 0x7001cae4 0x0 0x0b0>,
        <0x0 0x7001cba0 0x0 0x460>,


        <0x0 0x7001d000 0x0 0x00c>,
        <0x0 0x7001d050 0x0 0x198>,
        <0x0 0x7001d200 0x0 0x024>,
        <0x0 0x7001d29c 0x0 0x1b8>,
        <0x0 0x7001d464 0x0 0x198>,
        <0x0 0x7001d604 0x0 0x3b0>,
        <0x0 0x7001d9bc 0x0 0x020>,
        <0x0 0x7001d9f8 0x0 0x08c>,
        <0x0 0x7001dae4 0x0 0x0b0>,
        <0x0 0x7001dba0 0x0 0x460>;

  interrupts = <0 77 0x4>;
  int_count = <8>;
  int_mask = <0x23D40>;

  channels = <2>;
  status = "disabled";
 };

 intc: interrupt-controller {
  compatible = "arm,cortex-a15-gic";
  #interrupt-cells = <3>;
  interrupt-controller;
  reg = <0x0 0x50041000 0x0 0x1000
         0x0 0x50042000 0x0 0x0100>;
  status = "disabled";
 };

 lic: interrupt-controller@60004000 {
  compatible = "nvidia,tegra-gic";
  interrupt-controller;
  reg = <0x0 0x60004000 0x0 0x40>,
        <0x0 0x60004100 0x0 0x40>,
        <0x0 0x60004200 0x0 0x40>,
        <0x0 0x60004300 0x0 0x40>,
        <0x0 0x60004400 0x0 0x40>,
        <0x0 0x60004500 0x0 0x40>;
  status = "disabled";
 };

 agic-controller {
  compatible = "nvidia,tegra210-agic";
  interrupt-controller;
  no-gic-extension;
  not-per-cpu;
  reg = <0x0 0x702f9000 0x0 0x2000>,
        <0x0 0x702fa000 0x0 0x2000>;
  interrupts = <0 102 0xf04>;
  status = "disabled";
 };

 timer {
  compatible = "arm,armv8-timer";
  interrupts = <1 13 0xf01
         1 14 0xf01
         1 11 0xf01
         1 10 0xf01>;
  clock-frequency = <19200000>;
  status = "disabled";
 };

 timer@60005000 {
  compatible = "nvidia,tegra210-timer";
  reg = <0x0 0x60005000 0x0 0x400>;
  interrupts = <0 176 4>,
        <0 177 4>,
        <0 178 4>,
        <0 179 4>;
  status = "disabled";
 };

 rtc {
  compatible = "nvidia,tegra-rtc";
  reg = <0x0 0x7000e000 0x0 0x100>;
  interrupts = <0 2 0x04>;
  status = "disabled";
 };

 apbdma: dma@60020000 {
  compatible = "nvidia,tegra124-apbdma";
  power-domains = <&mc_clk_pd>;
  reg = <0x0 0x60020000 0x0 0x1400>;
  interrupts = <0 104 0x04
         0 105 0x04
         0 106 0x04
         0 107 0x04
         0 108 0x04
         0 109 0x04
         0 110 0x04
         0 111 0x04
         0 112 0x04
         0 113 0x04
         0 114 0x04
         0 115 0x04
         0 116 0x04
         0 117 0x04
         0 118 0x04
         0 119 0x04
         0 128 0x04
         0 129 0x04
         0 130 0x04
         0 131 0x04
         0 132 0x04
         0 133 0x04
         0 134 0x04
         0 135 0x04
         0 136 0x04
         0 137 0x04
         0 138 0x04
         0 139 0x04
         0 140 0x04
         0 141 0x04
         0 142 0x04
         0 143 0x04>;
  #dma-cells = <1>;
  status = "disabled";
 };

 pinmux: pinmux@700008d4 {
                compatible = "nvidia,tegra210-pinmux";
                reg = <0x0 0x700008d4 0x0 0x2a5
                       0x0 0x70003000 0x0 0x290>;
  #gpio-range-cells = <3>;
  status = "disabled";
        };

 gpio: gpio@6000d000 {
                compatible = "nvidia,tegra210-gpio", "nvidia,tegra124-gpio", "nvidia,tegra30-gpio";
                reg = <0x0 0x6000d000 0x0 0x1000>;
                interrupts = <0 32 0x04
                                0 33 0x04
                                0 34 0x04
                                0 35 0x04
                                0 55 0x04
                                0 87 0x04
                                0 89 0x04
                                0 125 0x04>;
                #gpio-cells = <2>;
                gpio-controller;
                #interrupt-cells = <2>;
                interrupt-controller;
  gpio-ranges = <&pinmux 0 0 246>;
  status = "disabled";
        };

 xotg {
  compatible = "nvidia,tegra210-xotg";
  interrupts = <0 49 0x04
         0 20 0x04>;
  status = "disabled";
 };

 xusb_padctl {
  compatible = "nvidia,tegra210-padctl";
  status = "disabled";
 };

 xusb@70090000 {
  compatible = "nvidia,tegra210-xhci";
  power-domains = <&mc_clk_pd>;
  reg = <0x0 0x70090000 0x0 0x8000
         0x0 0x70098000 0x0 0x1000
         0x0 0x70099000 0x0 0x1000
         0x0 0x7009f000 0x0 0x1000>;
  interrupts = <0 39 0x04
         0 40 0x04
         0 49 0x04
         0 97 0x04
         0 21 0x04>;
  nvidia,hsic0 = /bits/8 <0x1 0x1 0x8 0xa 0 0 1 0x1c 0>;
  iommus = <&smmu 20>;
  status = "disabled";
 };

 uarta: serial@70006000 {
  compatible = "nvidia,tegra114-hsuart";
  reg = <0x0 0x70006000 0x0 0x40>;
  reg-shift = <2>;
  interrupts = <0 36 0x04>;
  iommus = <&smmu 14>;
                nvidia,dma-request-selector = <&apbdma 8>;
                dmas = <&apbdma 8>, <&apbdma 8>;
                dma-names = "rx", "tx";
  status = "disabled";
 };

 uartb: serial@70006040 {
  compatible = "nvidia,tegra114-hsuart";
  reg = <0x0 0x70006040 0x0 0x40>;
  reg-shift = <2>;
  interrupts = <0 37 0x04>;
  iommus = <&smmu 14>;
                nvidia,dma-request-selector = <&apbdma 9>;
                dmas = <&apbdma 9>, <&apbdma 9>;
                dma-names = "rx", "tx";
  status = "disabled";
 };

 uartc: serial@70006200 {
  compatible = "nvidia,tegra114-hsuart";
  reg = <0x0 0x70006200 0x0 0x40>;
  reg-shift = <2>;
  interrupts = <0 46 0x04>;
  nvidia,dma-request-selector = <&apbdma 10>;
  iommus = <&smmu 14>;
  dmas = <&apbdma 10>, <&apbdma 10>;
  dma-names = "rx", "tx";
  status = "disabled";
 };

 uartd: serial@70006300 {
  compatible = "nvidia,tegra114-hsuart";
  reg = <0x0 0x70006300 0x0 0x40>;
  reg-shift = <2>;
  interrupts = <0 90 0x04>;
  nvidia,dma-request-selector = <&apbdma 19>;
  iommus = <&smmu 14>;
  dmas = <&apbdma 19>, <&apbdma 19>;
  dma-names = "rx", "tx";
  status = "disabled";
 };

 sound {
  iommus = <&smmu 34>;
  status = "disabled";
 };

 sound_ref {
  iommus = <&smmu 34>;
  status = "disabled";
 };

 tegra_pwm: pwm@7000a000 {
  compatible = "nvidia,tegra124-pwm";
  reg = <0x0 0x7000a000 0x0 0x100>;
  #pwm-cells = <2>;
  status = "disabled";
 };

 spi0: spi@7000d400 {
  compatible = "nvidia,tegra210-spi";
  reg = <0x0 0x7000d400 0x0 0x200>;
  interrupts = <0 59 0x04>;
  nvidia,dma-request-selector = <&apbdma 15>;
  iommus = <&smmu 14>;
  #address-cells = <1>;
  #size-cells = <0>;
  dmas = <&apbdma 15>, <&apbdma 15>;
  dma-names = "rx", "tx";
  nvidia,clk-parents = "pll_p", "clk_m";
  status = "disabled";
 };

 spi1: spi@7000d600 {
  compatible = "nvidia,tegra210-spi";
  reg = <0x0 0x7000d600 0x0 0x200>;
  interrupts = <0 82 0x04>;
  nvidia,dma-request-selector = <&apbdma 16>;
  iommus = <&smmu 14>;
  #address-cells = <1>;
  #size-cells = <0>;
  dmas = <&apbdma 16>, <&apbdma 16>;
  dma-names = "rx", "tx";
  nvidia,clk-parents = "pll_p", "clk_m";
  status = "disabled";
 };

 spi2: spi@7000d800 {
  compatible = "nvidia,tegra210-spi";
  reg = <0x0 0x7000d800 0x0 0x200>;
  interrupts = <0 83 0x04>;
  nvidia,dma-request-selector = <&apbdma 17>;
  iommus = <&smmu 14>;
  #address-cells = <1>;
  #size-cells = <0>;
  dmas = <&apbdma 17>, <&apbdma 17>;
  dma-names = "rx", "tx";
  nvidia,clk-parents = "pll_p", "clk_m";
  status = "disabled";
 };

 spi3: spi@7000da00 {
  compatible = "nvidia,tegra210-spi";
  reg = <0x0 0x7000da00 0x0 0x200>;
  interrupts = <0 93 0x04>;
  nvidia,dma-request-selector = <&apbdma 18>;
  iommus = <&smmu 14>;
  #address-cells = <1>;
  #size-cells = <0>;
  dmas = <&apbdma 18>, <&apbdma 18>;
  dma-names = "rx", "tx";
  nvidia,clk-parents = "pll_p", "clk_m";
  status = "disabled";
 };

 qspi6: spi@70410000 {
  compatible = "nvidia,tegra210-qspi";
  reg = <0x0 0x70410000 0x0 0x1000>;
  interrupts = <0 10 0x04>;
  nvidia,dma-request-selector = <&apbdma 5>;
  iommus = <&smmu 14>;
  #address-cells = <1>;
  #size-cells = <0>;
  status = "disabled";
       };

 host1x: host1x {
  compatible = "nvidia,tegra210-host1x", "simple-bus";
  power-domains = <&host1x_pd>;
  wakeup-capable;
  reg = <0x0 0x50000000 0x0 0x00034000>;
  interrupts = <0 65 0x04
         0 67 0x04>;
  iommus = <&smmu 6>;

  #address-cells = <2>;
  #size-cells = <2>;
  status = "disabled";

  ranges;

  nvidia,ch-base = <0>;
  nvidia,nb-channels = <12>;

  nvidia,nb-hw-pts = <192>;
  nvidia,pts-base = <0>;
  nvidia,nb-pts = <192>;

  vi {
   compatible = "nvidia,tegra210-vi", "simple-bus";
   power-domains = <&ve_pd>;
   reg = <0x0 0x54080000 0x0 0x40000>;
   interrupts = <0 69 0x00000004>;
   iommus = <&smmu 18>;
   status = "disabled";
   clocks = <&tegra_car 20>,
     <&tegra_car 52>,
     <&tegra_car 243>,
     <&tegra_car 144>,
     <&tegra_car 145>,
     <&tegra_car 146>;
   clock-names = "vi", "csi", "pll_d",
     "cilab", "cilcd", "cile";
   resets = <&tegra_car 20>;
   reset-names = "vi";
   #address-cells = <1>;
   #size-cells = <0>;
  };

  vi-bypass {
   compatible = "nvidia,tegra210-vi-bypass";
   status = "okay";
  };

  isp@54600000 {
   compatible = "nvidia,tegra210-isp";
   power-domains = <&ve_pd>;
   reg = <0x0 0x54600000 0x0 0x00040000>;
   interrupts = <0 71 0x04>;
   iommus = <&smmu 8>;
   status = "disabled";
  };

  isp@54680000 {
   compatible = "nvidia,tegra210-isp";
   power-domains = <&ve2_pd>;
   reg = <0x0 0x54680000 0x0 0x00040000>;
   interrupts = <0 70 0x04>;
   iommus = <&smmu 29>;
   status = "disabled";
  };

  dc@54200000 {
   compatible = "nvidia,tegra210-dc";
   power-domains = <&mc_clk_pd>;
   reg = <0x0 0x54200000 0x0 0x00040000>;
   interrupts = <0 73 0x04>;
   iommus = <&smmu 2>,
     <&smmu 10>;
   status = "disabled";

   rgb {
    status = "disabled";
   };
  };

  dc@54240000 {
   compatible = "nvidia,tegra210-dc";
   power-domains = <&mc_clk_pd>;
   reg = <0x0 0x54240000 0x0 0x00040000>;
   interrupts = <0 74 0x04>;
   iommus = <&smmu 3>;
   status = "disabled";

   rgb {
    status = "disabled";
   };
  };

  dsi {
   compatible = "nvidia,tegra210-dsi";
   reg = <0x0 0x54300000 0x0 0x00040000
          0x0 0x54400000 0x0 0x00040000>;
   status = "disabled";
  };

  vic {
   compatible = "nvidia,tegra210-vic";
   power-domains = <&vic03_pd>;
   reg = <0x0 0x54340000 0x0 0x00040000>;
   iommus = <&smmu 19>;
   status = "disabled";
  };

  nvenc {
   compatible = "nvidia,tegra210-nvenc";
   power-domains = <&msenc_pd>;
   reg = <0x0 0x544c0000 0x0 0x00040000>;
   iommus = <&smmu 11>;
   status = "disabled";
  };

  tsec {
   compatible = "nvidia,tegra210-tsec";
   power-domains = <&tsec_pd>;
   reg = <0x0 0x54500000 0x0 0x00040000>;
   iommus = <&smmu 23>;
   status = "disabled";
  };

  tsecb {
   compatible = "nvidia,tegra210-tsec";
   power-domains = <&tsec_pd>;
   reg = <0x0 0x54100000 0x0 0x00040000>;
   iommus = <&smmu 41>;
   status = "disabled";
  };

  nvdec {
   compatible = "nvidia,tegra210-nvdec";
   power-domains = <&nvdec_pd>;
   reg = <0x0 0x54480000 0x0 0x00040000>;
   iommus = <&smmu 33>;
   status = "disabled";
  };

  nvjpg {
   compatible = "nvidia,tegra210-nvjpg";
   power-domains = <&nvjpg_pd>;
   reg = <0x0 0x54380000 0x0 0x00040000>;
   iommus = <&smmu 36>;
   status = "disabled";
  };

  sor {
   compatible = "nvidia,tegra210-sor";
   reg = <0x0 0x54540000 0x0 0x00040000>;
   status = "disabled";
   nvidia,xbar-ctrl = <2 1 0 3 4>;
  };

  sor1 {
   compatible = "nvidia,tegra210-sor1";
   reg = <0x0 0x54580000 0x0 0x00040000>;
   interrupts = <0 76 0x4>;
   status = "disabled";
   nvidia,xbar-ctrl = <2 1 0 3 4>;
  };

  dpaux {
   compatible = "nvidia,tegra210-dpaux";
   reg = <0x0 0x545c0000 0x0 0x00040000>;
   interrupts = <0 159 0x4>;
   status = "disabled";
  };

  dpaux1 {
   compatible = "nvidia,tegra210-dpaux1";
   reg = <0x0 0x54040000 0x0 0x00040000>;
   interrupts = <0 11 0x4>;
   status = "disabled";
  };
  i2c7: i2c@546c0000 {
   #address-cells = <1>;
   #size-cells = <0>;
   compatible = "nvidia,tegra210-vii2c";
   reg = <0x0 0x546C0000 0x0 0x00034000>;
   iommus = <&smmu 18>;
   interrupts = <0 17 0x04>;
   scl-gpio = <&gpio ((18 * 8) + 2) 0>;
   sda-gpio = <&gpio ((18 * 8) + 3) 0>;
   status = "disabled";
   clock-frequency = <400000>;
  };
 };

 gpu {
  compatible = "nvidia,tegra210-gm20b", "nvidia,gm20b";
  nvidia,host1x = <&host1x>;
  power-domains = <&gpu_pd>;
  reg = <0x0 0x57000000 0x0 0x01000000>,
      <0x0 0x58000000 0x0 0x01000000>,
      <0x0 0x538f0000 0x0 0x00001000>;
  interrupts = <0 157 0x00000004>,
        <0 158 0x00000004>;
  interrupt-names = "stall", "nonstall";
  iommus = <&smmu 31>;
  access-vpr-phys;
  status = "disabled";
 };

 mipical {
  compatible = "nvidia,tegra210-mipical";
  reg = <0x0 0x700e3000 0x0 0x00000100>;
  status = "disabled";
 };

 tegra_pmc: pmc@7000e400 {
  compatible = "nvidia,tegra210-pmc";
  reg = <0x0 0x7000e400 0x0 0x400>;
  #padcontroller-cells = <1>;
  status = "disabled";
  io-pad-defaults {
   audio {
    nvidia,io-pad-init-voltage = <1800000>;
   };

   cam {
    nvidia,io-pad-init-voltage = <1800000>;
   };

   dbg {
    nvidia,io-pad-init-voltage = <1800000>;
   };

   dmic {
    nvidia,io-pad-init-voltage = <1800000>;
   };

   pex-ctrl {
    nvidia,io-pad-init-voltage = <1800000>;
   };

   spi {
    nvidia,io-pad-init-voltage = <1800000>;
   };

   uart {
    nvidia,io-pad-init-voltage = <1800000>;
   };

   bb {
    nvidia,io-pad-init-voltage = <1800000>;
   };
  };
 };

 adma: adma@702e2000 {
  compatible = "nvidia,tegra210-adma";
  power-domains = <&ape_pd>;
  reg = <0x0 0x702e2000 0x0 0x2000>;
  interrupts = <0 24 0x04
         0 25 0x04
         0 26 0x04
         0 27 0x04
         0 28 0x04
         0 29 0x04
         0 30 0x04
         0 31 0x04
         0 32 0x04
         0 33 0x04
         0 34 0x04
         0 35 0x04
         0 36 0x04
         0 37 0x04
         0 38 0x04
         0 39 0x04
         0 40 0x04
         0 41 0x04
         0 42 0x04
         0 43 0x04
         0 44 0x04
         0 45 0x04>;
   #dma-cells = <1>;
   dma-channels = <22>;
  status = "disabled";
 };

 se: se@70012000 {
  compatible = "nvidia,tegra210-se";
  power-domains = <&mc_clk_pd>;
  reg = <0x0 0x70012000 0x0 0x2000
   0x0 0x7000e400 0x0 0x400>;
  interrupts = <0 58 0x04>;
  status = "disabled";
 };

 tegra_axbar: ahub {
  compatible = "nvidia,tegra210-axbar";
  power-domains = <&ape_pd>;
  reg = <0x0 0x702d0800 0x0 0x800>;
  status = "disabled";

  #address-cells = <1>;
  #size-cells = <1>;
  ranges = <0x702d0000 0x0 0x702d0000 0x00010000>;

  tegra_admaif: admaif@0x702d0000 {
   compatible = "nvidia,tegra210-admaif";
   reg = <0x702d0000 0x800>;
   dmas = <&adma 1>, <&adma 1>, <&adma 2>, <&adma 2>,
    <&adma 3>, <&adma 3>, <&adma 4>, <&adma 4>,
    <&adma 5>, <&adma 5>, <&adma 6>, <&adma 6>,
    <&adma 7>, <&adma 7>, <&adma 8>, <&adma 8>,
    <&adma 9>, <&adma 9>, <&adma 10>, <&adma 10>;
   dma-names = "rx1", "tx1", "rx2", "tx2", "rx3", "tx3",
    "rx4", "tx4", "rx5", "tx5", "rx6", "tx6",
    "rx7", "tx7", "rx8", "tx8", "rx9", "tx9",
    "rx10", "tx10";
   status = "disabled";
  };

  tegra_sfc1: sfc@702d2000 {
   compatible = "nvidia,tegra210-sfc";
   reg = <0x702d2000 0x200>;
   nvidia,ahub-sfc-id = <0>;
   status = "disabled";
  };

  tegra_sfc2: sfc@702d2200 {
   compatible = "nvidia,tegra210-sfc";
   reg = <0x702d2200 0x200>;
   nvidia,ahub-sfc-id = <1>;
   status = "disabled";
  };

  tegra_sfc3: sfc@702d2400 {
   compatible = "nvidia,tegra210-sfc";
   reg = <0x702d2400 0x200>;
   nvidia,ahub-sfc-id = <2>;
   status = "disabled";
  };

  tegra_sfc4: sfc@702d2600 {
   compatible = "nvidia,tegra210-sfc";
   reg = <0x702d2600 0x200>;
   nvidia,ahub-sfc-id = <3>;
   status = "disabled";
  };

  spkprot@702d8c00 {
   compatible = "nvidia,tegra210-spkprot";
   reg = <0x702d8c00 0x400>;
   nvidia,ahub-spkprot-id = <0>;
   status = "disabled";
  };

  tegra_amixer: amixer@702dbb00 {
   compatible = "nvidia,tegra210-amixer";
   reg = <0x702dbb00 0x800>;
   nvidia,ahub-amixer-id = <0>;
   status = "disabled";
  };

  tegra_i2s1: i2s@702d1000 {
   compatible = "nvidia,tegra210-i2s";
   reg = <0x702d1000 0x100>;
   nvidia,ahub-i2s-id = <0>;
   status = "disabled";
  };

  tegra_i2s2: i2s@702d1100 {
   compatible = "nvidia,tegra210-i2s";
   reg = <0x702d1100 0x100>;
   nvidia,ahub-i2s-id = <1>;
   status = "disabled";
  };

  tegra_i2s3: i2s@702d1200 {
   compatible = "nvidia,tegra210-i2s";
   reg = <0x702d1200 0x100>;
   nvidia,ahub-i2s-id = <2>;
   status = "disabled";
  };

  tegra_i2s4: i2s@702d1300 {
   compatible = "nvidia,tegra210-i2s";
   reg = <0x702d1300 0x100>;
   nvidia,ahub-i2s-id = <3>;
   status = "disabled";
  };

  tegra_i2s5: i2s@702d1400 {
   compatible = "nvidia,tegra210-i2s";
   reg = <0x702d1400 0x100>;
   nvidia,ahub-i2s-id = <4>;
   status = "disabled";
  };

  tegra_amx1: amx@702d3000 {
   compatible = "nvidia,tegra210-amx";
   reg = <0x702d3000 0x100>;
   nvidia,ahub-amx-id = <0>;
   status = "disabled";
  };

  tegra_amx2: amx@702d3100 {
   compatible = "nvidia,tegra210-amx";
   reg = <0x702d3100 0x100>;
   nvidia,ahub-amx-id = <1>;
   status = "disabled";
  };

  tegra_adx1: adx@702d3800 {
   compatible = "nvidia,tegra210-adx";
   reg = <0x702d3800 0x100>;
   nvidia,ahub-adx-id = <0>;
   status = "disabled";
  };

  tegra_adx2: adx@702d3900 {
   compatible = "nvidia,tegra210-adx";
   reg = <0x702d3900 0x100>;
   nvidia,ahub-adx-id = <1>;
   status = "disabled";
  };

  tegra_dmic1: dmic@702d4000 {
   compatible = "nvidia,tegra210-dmic";
   reg = <0x702d4000 0x100>;
   nvidia,ahub-dmic-id = <0>;
   status = "disabled";
  };

  tegra_dmic2: dmic@702d4100 {
   compatible = "nvidia,tegra210-dmic";
   reg = <0x702d4100 0x100>;
   nvidia,ahub-dmic-id = <1>;
   status = "disabled";
  };

  tegra_dmic3: dmic@702d4200 {
   compatible = "nvidia,tegra210-dmic";
   reg = <0x702d4200 0x100>;
   nvidia,ahub-dmic-id = <2>;
   status = "disabled";
  };

  tegra_afc1: afc@702d7000 {
   compatible = "nvidia,tegra210-afc";
   reg = <0x702d7000 0x100>;
   nvidia,ahub-afc-id = <0>;
   status = "disabled";
  };

  tegra_afc2: afc@702d7100 {
   compatible = "nvidia,tegra210-afc";
   reg = <0x702d7100 0x100>;
   nvidia,ahub-afc-id = <1>;
   status = "disabled";
  };

  tegra_afc3: afc@702d7200 {
   compatible = "nvidia,tegra210-afc";
   reg = <0x702d7200 0x100>;
   nvidia,ahub-afc-id = <2>;
   status = "disabled";
  };

  tegra_afc4: afc@702d7300 {
   compatible = "nvidia,tegra210-afc";
   reg = <0x702d7300 0x100>;
   nvidia,ahub-afc-id = <3>;
   status = "disabled";
  };

  tegra_afc5: afc@702d7400 {
   compatible = "nvidia,tegra210-afc";
   reg = <0x702d7400 0x100>;
   nvidia,ahub-afc-id = <4>;
   status = "disabled";
  };

  tegra_afc6: afc@702d7500 {
   compatible = "nvidia,tegra210-afc";
   reg = <0x702d7500 0x100>;
   nvidia,ahub-afc-id = <5>;
   status = "disabled";
  };

  tegra_mvc1: mvc@702da000 {
   compatible = "nvidia,tegra210-mvc";
   reg = <0x702da000 0x200>;
   nvidia,ahub-mvc-id = <0>;
   status = "disabled";
  };

  tegra_mvc2: mvc@702da200 {
   compatible = "nvidia,tegra210-mvc";
   reg = <0x702da200 0x200>;
   nvidia,ahub-mvc-id = <1>;
   status = "disabled";
  };

  tegra_spdif: spdif@702d6000 {
   compatible = "nvidia,tegra210-spdif";
   reg = <0x702d6000 0x200>;
   nvidia,ahub-spdif-id = <0>;
   status = "disabled";
  };

  tegra_iqc1: iqc@702de000 {
   compatible = "nvidia,tegra210-iqc";
   reg = <0x702de000 0x200>;
   nvidia,ahub-iqc-id = <0>;
   status = "disabled";
  };

  tegra_iqc2: iqc@702de200 {
   compatible = "nvidia,tegra210-iqc";
   reg = <0x702de200 0x200>;
   nvidia,ahub-iqc-id = <1>;
                        status = "disabled";
                };

  tegra_ope1: ope@702d8000 {
   compatible = "nvidia,tegra210-ope";
   reg = <0x702d8000 0x100>,
         <0x702d8100 0x100>,
         <0x702d8200 0x200>;
   nvidia,ahub-ope-id = <0>;
   status = "disabled";
  };

  tegra_ope2: ope@702d8400 {
   compatible = "nvidia,tegra210-ope";
   reg = <0x702d8400 0x100>,
         <0x702d8500 0x100>,
         <0x702d8600 0x200>;
   nvidia,ahub-ope-id = <1>;
   status = "disabled";
  };
 };

 hda@70030000 {
  compatible = "nvidia,tegra30-hda";
  power-domains = <&mc_clk_pd>;
  reg = <0x0 0x70030000 0x0 0x10000>;
  interrupts = <0 81 0x04>;
  status = "disabled";
 };

 tegra_adsp_audio: adsp_audio {
  compatible = "nvidia,tegra210-adsp-audio";
  power-domains = <&adsp_pd>;
  iommus = <&smmu 34>;
  status = "disabled";
 };

 adsp {
      compatible = "nvidia,tegra210-adsp";
      power-domains = <&adsp_pd>;
      reg = <0x0 0x702ef000 0x0 0x1000>,
     <0x0 0x702ec000 0x0 0x2000>,
     <0x0 0x702ee000 0x0 0x1000>,
     <0x0 0x702dc800 0x0 0x0>,
     <0x0 0x01000000 0x0 0x6f2c0000>,
     <0x0 0x70300000 0x0 0x8fd00000>;
      iommus = <&smmu 34>;
      nvidia,adsp_mem = <0x80300000 0x01000000>,
          <0x80B00000 0x00800000>,
          <0x00400000 0x00010000>;
      nvidia,adsp_unit_fpga_reset = <0x0 0x00000040>;
      status = "disabled";
 };

 pcie-controller {
  compatible = "nvidia,tegra210-pcie", "nvidia,tegra124-pcie";
  device_type = "pci";
  reg = <0x0 0x01003000 0x0 0x00000800
         0x0 0x01003800 0x0 0x00000800
         0x0 0x02000000 0x0 0x10000000>;
  reg-names = "pads", "afi", "cs";
  interrupts = <0 98 0x04>,
        <0 99 0x04>;
  interrupt-names = "intr", "msi";

  #interrupt-cells = <1>;
  interrupt-map-mask = <0 0 0 0>;
  interrupt-map = <0 0 0 0 &intc 0 98 0x04>;

  bus-range = <0x00 0xff>;
  #address-cells = <3>;
  #size-cells = <2>;

  ranges = <0x82000000 0 0x01000000 0x0 0x01000000 0 0x00001000
     0x82000000 0 0x01001000 0x0 0x01001000 0 0x00001000
     0x81000000 0 0x0 0x0 0x12000000 0 0x00010000
     0x82000000 0 0x13000000 0x0 0x13000000 0 0x0d000000
     0xc2000000 0 0x20000000 0x0 0x20000000 0 0x20000000>;

  status = "disabled";

  pci@1,0 {
   device_type = "pci";
   assigned-addresses = <0x82000800 0 0x01000000 0 0x1000>;
   reg = <0x000800 0 0 0 0>;
   status = "disabled";

   #address-cells = <3>;
   #size-cells = <2>;
   ranges;

   nvidia,num-lanes = <4>;
  };

  pci@2,0 {
   device_type = "pci";
   assigned-addresses = <0x82001000 0 0x01001000 0 0x1000>;
   reg = <0x001000 0 0 0 0>;
   status = "disabled";

   #address-cells = <3>;
   #size-cells = <2>;
   ranges;

   nvidia,num-lanes = <1>;
  };

 };

 sata@70020000 {
  compatible = "nvidia,tegra210-ahci-sata";
  reg = <0x0 0x70021000 0x0 0x00001000>,
   <0x0 0x70027000 0x0 0x00002000>,
   <0x0 0x70001100 0x0 0x00000021>;
  interrupts = <0 23 0x04>;
  iommus = <&smmu 15>;
  status = "disabled";
 };

 i2c1: i2c@7000c000 {
  #address-cells = <1>;
  #size-cells = <0>;
  compatible = "nvidia,tegra210-i2c";
  reg = <0x0 0x7000c000 0x0 0x100>;
  interrupts = <0 38 0x04>;
  iommus = <&smmu 14>;
  status = "disabled";
  clock-frequency = <400000>;
 };

 i2c2: i2c@7000c400 {
  #address-cells = <1>;
  #size-cells = <0>;
  compatible = "nvidia,tegra210-i2c";
  reg = <0x0 0x7000c400 0x0 0x100>;
  interrupts = <0 84 0x04>;
  iommus = <&smmu 14>;
  status = "disabled";
  clock-frequency = <100000>;
 };

 i2c3: i2c@7000c500 {
  #address-cells = <1>;
  #size-cells = <0>;
  compatible = "nvidia,tegra210-i2c";
  reg = <0x0 0x7000c500 0x0 0x100>;
  interrupts = <0 92 0x04>;
  iommus = <&smmu 14>;
  status = "disabled";
  clock-frequency = <400000>;
 };

 i2c4: i2c@7000c700 {
  #address-cells = <1>;
  #size-cells = <0>;
  compatible = "nvidia,tegra210-i2c";
  reg = <0x0 0x7000c700 0x0 0x100>;
  interrupts = <0 120 0x04>;
  iommus = <&smmu 14>;
  status = "disabled";
  clock-frequency = <100000>;
 };

 i2c5: i2c@7000d000 {
  #address-cells = <1>;
  #size-cells = <0>;
  compatible = "nvidia,tegra210-i2c";
  reg = <0x0 0x7000d000 0x0 0x100>;
  interrupts = <0 53 0x04>;
  scl-gpio = <&gpio 195 0>;
  sda-gpio = <&gpio 196 0>;
  nvidia,require-cldvfs-clock;
  iommus = <&smmu 14>;
  status = "disabled";
  clock-frequency = <400000>;
 };

 i2c6: i2c@7000d100 {
  #address-cells = <1>;
  #size-cells = <0>;
  compatible = "nvidia,tegra210-i2c";
  reg = <0x0 0x7000d100 0x0 0x100>;
  interrupts = <0 63 0x04>;
  iommus = <&smmu 14>;
  status = "disabled";
  clock-frequency = <400000>;
 };

 sdhci@700b0600 {
  compatible = "nvidia,tegra210-sdhci";
  power-domains = <&mc_clk_pd>;
  reg = <0x0 0x700b0600 0x0 0x200>;
  interrupts = < 0 31 0x04 >;
  iommus = <&smmu 28>;
  nvidia,runtime-pm-type = <1>;
  status = "disabled";
 };

 sdhci@700b0400 {
  compatible = "nvidia,tegra210-sdhci";
  power-domains = <&mc_clk_pd>;
  reg = <0x0 0x700b0400 0x0 0x200>;
  interrupts = < 0 19 0x04 >;
  iommus = <&smmu 27>;
  pwrdet-support;
  pad-controllers = <&tegra_pmc 29>;
  pad-names = "sdmmc";
  nvidia,runtime-pm-type = <0>;
  status = "disabled";
 };

 sdhci@700b0200 {
  compatible = "nvidia,tegra210-sdhci";
  power-domains = <&mc_clk_pd>;
  reg = <0x0 0x700b0200 0x0 0x200>;
  interrupts = < 0 15 0x04 >;
  nvidia,runtime-pm-type = <1>;
  status = "disabled";
 };

 sdhci@700b0000 {
  compatible = "nvidia,tegra210-sdhci";
  power-domains = <&mc_clk_pd>;
  reg = <0x0 0x700b0000 0x0 0x200>;
  interrupts = < 0 14 0x04 >;
  iommus = <&smmu 25>;
  pwrdet-support;
  pad-controllers = <&tegra_pmc 28>;
  pad-names = "sdmmc";
  nvidia,runtime-pm-type = <1>;
  status = "disabled";
 };

 efuse@7000f800 {
  compatible = "nvidia,tegra210-efuse";
  reg = <0x0 0x7000f800 0x0 0x400>;
  status = "disabled";
 };

 udc: udc@7d000000 {
  compatible = "nvidia,tegra210-udc";
  reg = <0x0 0x7d000000 0x0 0x4000>;
  interrupts = <0 20 0x04>;
  status = "disabled";
 };

 otg: otg@7d000000 {
  compatible = "nvidia,tegra132-otg";
  power-domains = <&mc_clk_pd>;
  reg = <0x0 0x7d000000 0x0 0x4000>;
  interrupts = <0 20 0x04>;
  nvidia,hc-device = <&ehci1>;
  status = "disabled";
 };

 ehci1: ehci@7d000000 {
  compatible = "nvidia,tegra132-ehci";
  power-domains = <&mc_clk_pd>;
  reg = <0x0 0x7d000000 0x0 0x4000>;
  interrupts = <0 20 0x04>;
  iommus = <&smmu 14>,
    <&smmu 24>,
    <&smmu 32>;
  nvidia,port-otg;
  nvidia,has-hostpc;
  nvidia,unaligned-dma-buf-supported;
  nvidia,power-off-on-suspend;
  nvidia,is-intf-utmi;
  nvidia,remote-wakeup-supported;
  nvidia,hssync-start-delay = <0>;
  nvidia,idle-wait-delay = <17>;
  nvidia,elastic-limit = <16>;
  nvidia,term-range-adj = <6>;
  nvidia,xcvr-setup = <8>;
  nvidia,xcvr-lsfslew = <2>;
  nvidia,xcvr-lsrslew = <2>;
  nvidia,xcvr-use-fuses;
  nvidia,vbus-oc-map = <5>;
  nvidia,xcvr-setup-offset = <0>;
  status = "disabled";
 };

 pmc-iopower {
  compatible = "nvidia,tegra210-pmc-iopower";
  pad-controllers = <&tegra_pmc 39
     &tegra_pmc 32
     &tegra_pmc 0
     &tegra_pmc 2
     &tegra_pmc 27
     &tegra_pmc 28
     &tegra_pmc 29
     &tegra_pmc 40
     &tegra_pmc 1
     &tegra_pmc 9
     &tegra_pmc 11
     &tegra_pmc 19
     &tegra_pmc 30
     &tegra_pmc 31>;
  pad-names = "sys", "uart", "audio", "cam", "pex-ctrl",
   "sdmmc1", "sdmmc3", "hv", "audio-hv", "debug", "dmic",
   "gpio", "spi", "spi-hv";
  status = "disabled";
 };

 dtv@7000c300 {
  compatible = "nvidia,tegra210-dtv";
  reg = <0x0 0x7000c300 0x0 0x100>;
  nvidia,dma-request-selector = <11>;
  dmas = <&apbdma 11>;
  dma-names = "rx";
  status = "disabled";
 };

 xudc@700d0000 {
  compatible = "nvidia,tegra210-xudc";
  reg = <0x0 0x700d0000 0x0 0x8000>,
   <0x0 0x700d8000 0x0 0x1000>,
   <0x0 0x700d9000 0x0 0x1000>,
   <0x0 0x7009f000 0x0 0x1000>;
  interrupts = <0 44 0x4
    0 49 0x4>;
  status = "disabled";
 };

 soctherm: soctherm@0x700E2000 {
  compatible = "nvidia,tegra-soctherm";
  reg = <0x0 0x700E2000 0x0 0x600>,
   <0x0 0x60006000 0x0 0x400>,
   <0x0 0x70040000 0x0 0x200>;
  interrupts = <0 48 0x04
         0 51 0x04>;
  #thermal-sensor-cells = <1>;
  status = "disabled";
  interrupt-controller;
  #interrupt-cells = <2>;
  soctherm-clock-frequency = <51000000>;
  tsensor-clock-frequency = <400000>;
  sensor-params-tall = <16300>;
  sensor-params-tiddq = <1>;
  sensor-params-ten-count = <1>;
  sensor-params-tsample = <120>;
  sensor-params-pdiv = <8>;
  sensor-params-tsamp-ate = <480>;
  sensor-params-pdiv-ate = <8>;
  fuse_war@fuse_rev_0_1 {
   device_type = "fuse_war";
   match_fuse_rev = <0 1>;
   cpu0 = <1088700 397600 >;
   cpu1 = <1077600 1073200 >;
   cpu2 = <1104800 (-617000) >;
   cpu3 = <1093800 (-901200)>;
   mem0 = <1085300 (-98400) >;
   mem1 = <1104800 (-99000) >;
   gpu = <1085800 (-1097500)>;
   pllx = <1078800 (-890700)>;
  };
  fuse_war@fuse_rev_2 {
   device_type = "fuse_war";
   match_fuse_rev = <2>;
   cpu0 = <1085000 3244200 >;
   cpu1 = <1126200 (-67500) >;
   cpu2 = <1098400 2251100 >;
   cpu3 = <1108000 602700>;
   mem0 = <1069200 3549900>;
   mem1 = <1173700 (-6263600)>;
   gpu = <1074300 2734900>;
   pllx = <1039700 6829100>;
  };

  therm_cpu {
   device_type = "thermctl";
   thermal-sensor-id = <0>;
   hotspot-offset = <10000>;
  };
  therm_gpu {
   device_type = "thermctl";
   thermal-sensor-id = <1>;
   hotspot-offset = <5000>;
  };
  therm_mem {
   status = "disabled";
   device_type = "thermctl";
   thermal-sensor-id = <2>;
  };
  therm_pll {
   device_type = "thermctl";
   thermal-sensor-id = <3>;
  };


  throttle@critical {
   device_type = "throttlectl";
   cdev-type = "tegra-shutdown";
   cooling-min-state = <0>;
   cooling-max-state = <3>;
   #cooling-cells = <2>;
  };
  throttle@heavy {
   device_type = "throttlectl";
   cdev-type = "tegra-heavy";
   cooling-min-state = <0>;
   cooling-max-state = <3>;
   #cooling-cells = <2>;
   priority = <100>;
   throttle_dev = <&{/soctherm@0x700E2000/throttle_dev@cpu_high}
     &{/soctherm@0x700E2000/throttle_dev@gpu_high}>;
  };
  throttle_dev@cpu_high {
   depth = <85>;
  };
  throttle_dev@gpu_high {
   level = "heavy_throttling";
  };
 };

 tegra-aotag {
  compatible = "nvidia,tegra21x-aotag";
  parent-block = <&{/pmc@7000e400}>;




  status = "disabled";
  sensor-params-tall = <76>;
  sensor-params-tiddq = <1>;
  sensor-params-ten-count = <16>;
  sensor-params-tsample = <9>;
  sensor-params-pdiv = <8>;
  sensor-params-tsamp-ate = <39>;
  sensor-params-pdiv-ate = <8>;


  #thermal-sensor-cells = <0>;
# 1622 "arch/arm64/boot/dts/tegra210-soc-base.dtsi"
  sensor-name = "aotag0";
  sensor-id = <0>;
  advertised-sensor-id = <9>;





  sensor-nominal-temp-cp = <25>;
  sensor-nominal-temp-ft = <105>;

  sensor-compensation-a = <10632>;
  sensor-compensation-b = <(-67490)>;
 };

 tegra_cec {
  compatible = "nvidia,tegra210-cec";
  reg = <0x0 0x70015000 0x0 0x00001000>;
  interrupts = <0 3 0x04>;
  status = "disabled";
 };

 ehci2: ehci@7d004000 {
  compatible = "nvidia,tegra132-ehci";
  power-domains = <&mc_clk_pd>;
  reg = <0x0 0x7d004000 0x0 0x4000>;
  interrupts = <0 21 0x04>;
  iommus = <&smmu 14>,
    <&smmu 24>,
    <&smmu 32>;
  nvidia,has-hostpc;
  nvidia,power-off-on-suspend;
  nvidia,remote-wakeup-supported;
  nvidia,skip_resume;
  status = "disabled";
 };

 watchdog@60005100 {
  compatible = "nvidia,tegra-wdt";
  reg = <0x0 0x60005100 0x0 0x20
  0x0 0x60005070 0x0 0x8>;
  interrupts = <0 123 0x04>;
  nvidia,expiry-count = <4>;
  status = "disabled";
 };

        fiq_debugger {
  compatible = "nvidia,fiq-debugger";
  use-console-port;
  interrupts = <1 12 0x0108>;
        };

 ptm {
  compatible = "nvidia,ptm";
  reg = <0x0 0x72010000 0x0 0x1000>,
        <0x0 0x72030000 0x0 0x1000>,
        <0x0 0x72040000 0x0 0x1000>,
        <0x0 0x72050000 0x0 0x1000>,
        <0x0 0x72060000 0x0 0x1000>,
        <0x0 0x73010000 0x0 0x1000>,
        <0x0 0x73440000 0x0 0x1000>,
        <0x0 0x73540000 0x0 0x1000>,
        <0x0 0x73640000 0x0 0x1000>,
        <0x0 0x73740000 0x0 0x1000>,
        <0x0 0x72820000 0x0 0x1000>,
        <0x0 0x72a1c000 0x0 0x1000>;
 };

 mselect {
  compatible = "nvidia,tegra-mselect";
  interrupts = < 0 175 0x4 >;
  reg = < 0x0 0x50060000 0x0 0x1000 >;
  status = "disabled";
 };

 cpuidle {
  compatible = "nvidia,tegra210-cpuidle";
 };
};
# 17 "arch/arm64/boot/dts/tegra210-soc-shield.dtsi" 2
# 1 "arch/arm64/boot/dts/tegra210-platforms/tegra210-bthrot-cdev.dtsi" 1
# 21 "arch/arm64/boot/dts/tegra210-platforms/tegra210-bthrot-cdev.dtsi"
/{
 bthrot_cdev {
  compatible = "nvidia,balanced-throttle";
  skin_balanced {
   cdev-type = "skin-balanced";
   num_states = <66>;
   cooling-min-state = <0>;
   cooling-max-state = <66>;
   #cooling-cells = <2>;
   status = "disabled";
   throttle_table = <

    1861500 841000 480000 512000 384000 4294967295
    1836000 830000 480000 512000 384000 4294967295
    1810500 818000 480000 512000 384000 4294967295
    1785000 806000 480000 512000 384000 4294967295
    1759500 795000 480000 512000 384000 4294967295
    1734000 783000 480000 512000 384000 4294967295
    1708500 771000 480000 512000 384000 4294967295
    1683000 760000 480000 512000 384000 4294967295
    1657500 748000 480000 512000 384000 4294967295
    1632000 736000 480000 512000 384000 4294967295
    1606500 725000 480000 512000 384000 4294967295
    1581000 713000 480000 512000 384000 4294967295
    1555500 702000 480000 512000 384000 4294967295
    1530000 690000 480000 512000 384000 4294967295
    1504500 678000 480000 512000 384000 4294967295
    1479000 667000 480000 512000 384000 4294967295
    1453500 655000 480000 512000 384000 4294967295
    1428000 643000 480000 512000 384000 4294967295
    1402500 632000 480000 512000 384000 4294967295
    1377000 620000 480000 512000 384000 4294967295
    1351500 608000 480000 512000 384000 4294967295
    1326000 597000 480000 512000 384000 4294967295
    1300500 585000 480000 512000 384000 4294967295
    1275000 573000 480000 512000 384000 4294967295
    1249500 562000 480000 512000 384000 4294967295
    1224000 550000 480000 512000 384000 4294967295
    1198500 538000 480000 512000 384000 4294967295
    1173000 527000 480000 512000 384000 4294967295
    1147500 515000 480000 512000 384000 4294967295
    1122000 503000 480000 512000 384000 4294967295
    1096500 492000 480000 512000 384000 4294967295
    1071000 480000 480000 512000 384000 4294967295
    1045500 469000 480000 512000 384000 4294967295
    1020000 457000 480000 512000 384000 4294967295
    994500 445000 480000 512000 384000 4294967295
    969000 434000 480000 486400 384000 4294967295
    943500 422000 480000 486400 384000 4294967295
    918000 410000 480000 486400 384000 4294967295
    892500 399000 480000 486400 384000 4294967295
    867000 387000 480000 486400 384000 4294967295
    841500 375000 480000 486400 384000 4294967295
    816000 364000 480000 486400 384000 4294967295
    790500 352000 480000 486400 384000 4294967295
    765000 340000 480000 486400 384000 4294967295
    739500 329000 480000 473600 384000 4294967295
    714000 317000 480000 473600 384000 4294967295
    688500 305000 480000 473600 384000 4294967295
    663000 294000 480000 473600 384000 4294967295
    637500 282000 480000 473600 384000 4294967295
    612000 270000 480000 473600 384000 4294967295
    586500 259000 480000 473600 384000 4294967295
    561000 247000 480000 435200 384000 4294967295
    535500 235000 480000 435200 384000 4294967295
    510000 224000 480000 435200 384000 4294967295
    484500 212000 480000 435200 384000 4294967295
    459000 201000 480000 435200 384000 4294967295
    433500 189000 480000 435200 384000 4294967295
    408000 177000 480000 396800 384000 4294967295
    382500 166000 480000 396800 384000 4294967295
    357000 154000 480000 396800 384000 4294967295
    331500 142000 480000 396800 384000 4294967295
    306000 131000 480000 396800 384000 4294967295
    280500 119000 480000 396800 384000 4294967295
    255000 107000 480000 396800 384000 4294967295
    229500 96000 480000 396800 384000 4294967295
    204000 84000 480000 396800 384000 4294967295
   >;
  };
  gpu_balanced {
   cdev-type = "gpu-balanced";
   num_states = <66>;
   cooling-min-state = <0>;
   cooling-max-state = <66>;
   #cooling-cells = <2>;
   status = "disabled";
   throttle_table = <

    1861500 839000 480000 512000 384000 4294967295
    1836000 825000 480000 512000 384000 4294967295
    1810500 810000 480000 512000 384000 4294967295
    1785000 796000 480000 512000 384000 4294967295
    1759500 782000 480000 512000 384000 4294967295
    1734000 768000 480000 512000 384000 4294967295
    1708500 753000 480000 512000 384000 4294967295
    1683000 739000 480000 512000 384000 4294967295
    1657500 725000 480000 512000 384000 4294967295
    1632000 711000 480000 512000 384000 4294967295
    1606500 696000 480000 512000 384000 4294967295
    1581000 682000 480000 512000 384000 4294967295
    1555500 668000 480000 512000 384000 4294967295
    1530000 654000 480000 512000 384000 4294967295
    1504500 639000 480000 512000 384000 4294967295
    1479000 625000 480000 512000 384000 4294967295
    1453500 611000 480000 512000 384000 4294967295
    1428000 597000 480000 512000 384000 4294967295
    1402500 582000 480000 512000 384000 4294967295
    1377000 568000 480000 512000 384000 4294967295
    1351500 554000 480000 512000 384000 4294967295
    1326000 540000 480000 512000 384000 4294967295
    1300500 525000 480000 512000 384000 4294967295
    1275000 511000 480000 512000 384000 4294967295
    1249500 497000 480000 512000 384000 4294967295
    1224000 483000 480000 512000 384000 4294967295
    1198500 469000 480000 512000 384000 4294967295
    1173000 454000 480000 512000 384000 4294967295
    1147500 440000 480000 512000 384000 4294967295
    1122000 426000 480000 512000 384000 4294967295
    1096500 412000 480000 512000 384000 4294967295
    1071000 397000 480000 512000 384000 4294967295
    1045500 383000 480000 512000 384000 4294967295
    1020000 369000 480000 512000 384000 4294967295
    994500 355000 480000 512000 384000 4294967295
    969000 340000 480000 486400 384000 4294967295
    943500 326000 480000 486400 384000 4294967295
    918000 312000 480000 486400 384000 4294967295
    892500 298000 480000 486400 384000 4294967295
    867000 283000 480000 486400 384000 4294967295
    841500 269000 480000 486400 384000 4294967295
    816000 255000 480000 486400 384000 4294967295
    790500 241000 480000 486400 384000 4294967295
    765000 226000 480000 486400 384000 4294967295
    739500 212000 480000 473600 384000 4294967295
    714000 198000 480000 473600 384000 4294967295
    688500 184000 480000 473600 384000 4294967295
    663000 169000 480000 473600 384000 4294967295
    637500 155000 480000 473600 384000 4294967295
    612000 141000 480000 473600 384000 4294967295
    586500 127000 480000 473600 384000 4294967295
    561000 112000 480000 435200 384000 4294967295
    535500 98000 480000 435200 384000 4294967295
    510000 84000 480000 435200 384000 4294967295
    484500 84000 480000 435200 384000 4294967295
    459000 84000 480000 435200 384000 4294967295
    433500 84000 480000 435200 384000 4294967295
    408000 84000 480000 396800 384000 4294967295
    382500 84000 480000 396800 384000 4294967295
    357000 84000 480000 396800 384000 4294967295
    331500 84000 480000 396800 384000 4294967295
    306000 84000 480000 396800 384000 4294967295
    280500 84000 480000 396800 384000 4294967295
    255000 84000 480000 396800 384000 4294967295
    229500 84000 480000 396800 384000 4294967295
    204000 84000 480000 396800 384000 4294967295
   >;
  };
  cpu_balanced {
   cdev-type = "cpu-balanced";
   num_states = <66>;
   cooling-min-state = <0>;
   cooling-max-state = <66>;
   #cooling-cells = <2>;
   status = "disabled";
   throttle_table = <

    1861500 853000 480000 512000 384000 4294967295
    1836000 853000 480000 512000 384000 4294967295
    1810500 853000 480000 512000 384000 4294967295
    1785000 853000 480000 512000 384000 4294967295
    1759500 853000 480000 512000 384000 4294967295
    1734000 853000 480000 512000 384000 4294967295
    1708500 853000 480000 512000 384000 4294967295
    1683000 853000 480000 512000 384000 4294967295
    1657500 853000 480000 512000 384000 4294967295
    1632000 853000 480000 512000 384000 4294967295
    1606500 839000 480000 512000 384000 4294967295
    1581000 826000 480000 512000 384000 4294967295
    1555500 812000 480000 512000 384000 4294967295
    1530000 798000 480000 512000 384000 4294967295
    1504500 784000 480000 512000 384000 4294967295
    1479000 771000 480000 512000 384000 4294967295
    1453500 757000 480000 512000 384000 4294967295
    1428000 743000 480000 512000 384000 4294967295
    1402500 729000 480000 512000 384000 4294967295
    1377000 716000 480000 512000 384000 4294967295
    1351500 702000 480000 512000 384000 4294967295
    1326000 688000 480000 512000 384000 4294967295
    1300500 674000 480000 512000 384000 4294967295
    1275000 661000 480000 512000 384000 4294967295
    1249500 647000 480000 512000 384000 4294967295
    1224000 633000 480000 512000 384000 4294967295
    1198500 620000 480000 512000 384000 4294967295
    1173000 606000 480000 512000 384000 4294967295
    1147500 592000 480000 512000 384000 4294967295
    1122000 578000 480000 512000 384000 4294967295
    1096500 565000 480000 512000 384000 4294967295
    1071000 551000 480000 512000 384000 4294967295
    1045500 537000 480000 512000 384000 4294967295
    1020000 523000 480000 512000 384000 4294967295
    994500 510000 480000 512000 384000 4294967295
    969000 496000 480000 486400 384000 4294967295
    943500 482000 480000 486400 384000 4294967295
    918000 469000 480000 486400 384000 4294967295
    892500 455000 480000 486400 384000 4294967295
    867000 441000 480000 486400 384000 4294967295
    841500 427000 480000 486400 384000 4294967295
    816000 414000 480000 486400 384000 4294967295
    790500 400000 480000 486400 384000 4294967295
    765000 386000 480000 486400 384000 4294967295
    739500 372000 480000 473600 384000 4294967295
    714000 359000 480000 473600 384000 4294967295
    688500 345000 480000 473600 384000 4294967295
    663000 331000 480000 473600 384000 4294967295
    637500 317000 480000 473600 384000 4294967295
    612000 304000 480000 473600 384000 4294967295
    586500 290000 480000 473600 384000 4294967295
    561000 276000 480000 435200 384000 4294967295
    535500 263000 480000 435200 384000 4294967295
    510000 249000 480000 435200 384000 4294967295
    484500 235000 480000 435200 384000 4294967295
    459000 221000 480000 435200 384000 4294967295
    433500 208000 480000 435200 384000 4294967295
    408000 194000 480000 396800 384000 4294967295
    382500 180000 480000 396800 384000 4294967295
    357000 166000 480000 396800 384000 4294967295
    331500 153000 480000 396800 384000 4294967295
    306000 139000 480000 396800 384000 4294967295
    280500 125000 480000 396800 384000 4294967295
    255000 111000 480000 396800 384000 4294967295
    229500 98000 480000 396800 384000 4294967295
    204000 84000 480000 396800 384000 4294967295
   >;
  };
  emergency_balanced {
   cdev-type = "emergency-balanced";
   num_states = <1>;
   cooling-min-state = <0>;
   cooling-max-state = <1>;
   #cooling-cells = <2>;
   status = "disabled";
   throttle_table = <

    1122000 391000 288000 420000 252000 396000
   >;
  };
 };
};
# 18 "arch/arm64/boot/dts/tegra210-soc-shield.dtsi" 2

/ {
 aliases {
  i2c0 = &i2c1;
  i2c1 = &i2c2;
  i2c2 = &i2c3;
  i2c3 = &i2c4;
  i2c4 = &i2c5;
  i2c5 = &i2c6;
  i2c6 = &i2c7;
  spi0 = &spi0;
  spi1 = &spi1;
  spi2 = &spi2;
  spi3 = &spi3;
  qspi6 = &qspi6;
  serial0 = &uarta;
  serial1 = &uartb;
  serial2 = &uartc;
  serial3 = &uartd;
  udc0 = &udc;
  ehci0 = &ehci1;
  ehci1 = &ehci2;
  rtc0 = "/rtc";
  rtc1 = "/i2c@7000d000/max77620@3c";
 };

 cpus {
  status = "okay";

  cpu@0 {
   status = "okay";
  };

  cpu@1 {
   status = "okay";
  };

  cpu@2 {
   status = "okay";
  };

  cpu@3 {
   status = "okay";
  };
 };

 psci {
  status = "okay";
 };

 arm-pmu {
  status = "okay";
 };

 clock {
  status = "okay";
 };

 iommu {
  status = "okay";
 };

 bpmp {
  status = "okay";
 };

 mc {
  status = "okay";
 };

 interrupt-controller {
  status = "okay";
 };

 interrupt-controller@60004000 {
  status = "okay";
 };

 agic-controller {
  status = "okay";
 };

 timer {
  status = "okay";
 };

 timer@60005000 {
  status = "okay";
 };

 rtc {
  status = "okay";
 };

 dma@60020000 {
  status = "okay";
 };

 pinmux@700008d4 {
  status = "okay";
        };

 gpio@6000d000 {
  status = "okay";
        };

 xusb@70090000 {
  status = "okay";
 };

 serial@70006000 {
  status = "disabled";
 };

 serial@70006040 {
  status = "disabled";
 };

 serial@70006200 {
  status = "disabled";
 };

 serial@70006300 {
  status = "disabled";
 };

 sound {
  status = "okay";
 };

 sound_ref {
  status = "okay";
 };

 pwm@7000a000 {
  status = "okay";
 };

 spi@7000d400 {
  status = "disabled";
 };

 spi@7000d600 {
  status = "disabled";
 };

 spi@7000d800 {
  status = "disabled";
 };

 spi@7000da00 {
  status = "disabled";
 };

 spi@70410000 {
  status = "disabled";
 };

 host1x {
  status = "okay";
  vi {
   status = "okay";
  };

  isp@54600000 {
   status = "okay";
  };

  isp@54680000 {
   status = "okay";
  };

  dc@54200000 {
   status = "disabled";
  };

  dc@54240000 {
   status = "disabled";
  };

  dsi {
   status = "disabled";
  };

  vic {
   status = "okay";
  };

  nvenc {
   status = "okay";
  };

  tsec {
   status = "okay";
  };

  tsecb {
   status = "okay";
  };

  nvdec {
   status = "okay";
  };

  nvjpg {
   status = "okay";
  };

  sor {
   status = "disabled";
  };

  sor1 {
   status = "disabled";
  };

  dpaux {
   status = "disabled";
  };

  dpaux1 {
   status = "disabled";
  };

  i2c@546c0000 {
   status = "okay";
  };
 };

 gpu {
  status = "okay";
 };

 mipical {
  status = "okay";
 };

 pmc@7000e400 {
  status = "okay";
 };

 adma@702e2000 {
  status = "okay";
 };

 se@70012000 {
  status = "okay";
 };

 ahub {
  status = "disabled";
  admaif@0x702d0000 {
   status = "disabled";
  };

  sfc@702d2000 {
   status = "disabled";
  };

  sfc@702d2200 {
   status = "disabled";
  };

  sfc@702d2400 {
   status = "disabled";
  };

  sfc@702d2600 {
   status = "disabled";
  };

  spkprot@702d8c00 {
   status = "disabled";
  };

  amixer@702dbb00 {
   status = "disabled";
  };

  i2s@702d1000 {
   status = "disabled";
  };

  i2s@702d1100 {
   status = "disabled";
  };

  i2s@702d1200 {
   status = "disabled";
  };

  i2s@702d1300 {
   status = "disabled";
  };

  i2s@702d1400 {
   status = "disabled";
  };

  amx@702d3000 {
   status = "disabled";
  };

  amx@702d3100 {
   status = "disabled";
  };

  adx@702d3800 {
   status = "disabled";
  };

  adx@702d3900 {
   status = "disabled";
  };

  dmic@702d4000 {
   status = "disabled";
  };

  dmic@702d4100 {
   status = "disabled";
  };

  dmic@702d4200 {
   status = "disabled";
  };

  afc@702d7000 {
   status = "disabled";
  };

  afc@702d7100 {
   status = "disabled";
  };

  afc@702d7200 {
   status = "disabled";
  };

  afc@702d7300 {
   status = "disabled";
  };

  afc@702d7400 {
   status = "disabled";
  };

  afc@702d7500 {
   status = "disabled";
  };

  mvc@702da000 {
   status = "disabled";
  };

  mvc@702da200 {
   status = "disabled";
  };

  spdif@702d6000 {
   status = "disabled";
  };

  iqc@702de000 {
   status = "disabled";
  };

  iqc@702de200 {
                        status = "disabled";
                };

  ope@702d8000 {
   status = "disabled";
  };

  ope@702d8400 {
   status = "disabled";
  };
 };

 hda@70030000 {
  status = "okay";
 };

 adsp_audio {
  status = "disabled";
 };

 adsp {
  status = "okay";
 };

 pcie-controller {
  status = "disabled";
 };

 sata@70020000 {
  status = "disabled";
 };

 i2c@7000c000 {
  status = "okay";
 };

 i2c@7000c400 {
  status = "okay";
 };

 i2c@7000c500 {
  status = "okay";
 };

 i2c@7000c700 {
  status = "okay";
 };

 i2c@7000d000 {
  status = "okay";
 };

 i2c@7000d100 {
  status = "okay";
 };

 sdhci@700b0600 {
  status = "disabled";
 };

 sdhci@700b0400 {
  status = "disabled";
 };

 sdhci@700b0200 {
  status = "disabled";
 };

 sdhci@700b0000 {
  status = "disabled";
 };

 efuse@7000f800 {
  status = "okay";
 };

 udc@7d000000 {
  status = "disabled";
 };

 otg@7d000000 {
  status = "disabled";
 };

 pmc-iopower {
  status = "okay";
 };

 dtv@7000c300 {
  status = "disabled";
 };

 xudc@700d0000 {
  status = "disabled";
 };

 xotg {
  status = "disabled";
 };

 soctherm@0x700E2000 {
  status = "okay";
 };

 tegra-aotag {
  status = "okay";
 };

 tegra_cec {
  status = "okay";
 };

 ehci@7d004000 {
  status = "disabled";
 };

 watchdog@60005100 {
  status = "disabled";
 };

 ptm {
  status = "okay";
 };

 thermal-zones {
  AO-therm {
   status = "disabled";
  };

  CPU-therm {
   status = "okay";
  };
  GPU-therm {
   status = "okay";
  };
  LCPU-therm {
   status = "disabled";
  };
  PLL-therm {
   status = "okay";
  };
 };

 mselect {
  status = "disabled";
 };

 bthrot_cdev {
  skin_balanced {
   status = "okay";
  };
  gpu_balanced {
   status = "okay";
  };
  cpu_balanced {
   status = "okay";
  };
  emergency_balanced {
   status = "okay";
  };
 };
};
# 26 "arch/arm64/boot/dts/tegra210-grenada.dts" 2
# 1 "arch/arm64/boot/dts/tegra210-platforms/tegra210-grenada-fixed.dtsi" 1


/ {
 regulators {
  compatible = "simple-bus";
  device_type = "fixed-regulators";

  #address-cells = <1>;
  #size-cells = <0>;

  battery_reg: regulator@0 {
   compatible = "regulator-fixed";
   reg = <0>;
   regulator-name = "vdd-ac-bat";
   consumers {
    c1 {
     regulator-consumer-supply = "dvdd-pex-pll";
     regulator-consumer-device = "pcie-controller.3";
    };
    c2 {
     regulator-consumer-supply = "hvdd-pex-pll-e";
     regulator-consumer-device = "pcie-controller.3";
    };
    c3 {
     regulator-consumer-supply = "l0-hvddio-pex";
     regulator-consumer-device = "pcie-controller.3";
    };
    c4 {
     regulator-consumer-supply = "l0-dvddio-pex";
     regulator-consumer-device = "pcie-controller.3";
    };
    c5 {
     regulator-consumer-supply = "l1-hvddio-pex";
     regulator-consumer-device = "pcie-controller.3";
    };
    c6 {
     regulator-consumer-supply = "l1-dvddio-pex";
     regulator-consumer-device = "pcie-controller.3";
    };
    c7 {
     regulator-consumer-supply = "l2-hvddio-pex";
     regulator-consumer-device = "pcie-controller.3";
    };
    c8 {
     regulator-consumer-supply = "l2-dvddio-pex";
     regulator-consumer-device = "pcie-controller.3";
    };
    c9 {
     regulator-consumer-supply = "l3-hvddio-pex";
     regulator-consumer-device = "pcie-controller.3";
    };
    c10 {
     regulator-consumer-supply = "l3-dvddio-pex";
     regulator-consumer-device = "pcie-controller.3";
    };
    c11 {
     regulator-consumer-supply = "l4-hvddio-pex";
     regulator-consumer-device = "pcie-controller.3";
    };
    c12 {
     regulator-consumer-supply = "l4-dvddio-pex";
     regulator-consumer-device = "pcie-controller.3";
    };
    c13 {
     regulator-consumer-supply = "l5-hvddio-pex";
     regulator-consumer-device = "pcie-controller.3";
    };
    c14 {
     regulator-consumer-supply = "l5-dvddio-pex";
     regulator-consumer-device = "pcie-controller.3";
    };
    c15 {
     regulator-consumer-supply = "l6-hvddio-pex";
     regulator-consumer-device = "pcie-controller.3";
    };
    c16 {
     regulator-consumer-supply = "l6-dvddio-pex";
     regulator-consumer-device = "pcie-controller.3";
    };
    c17 {
     regulator-consumer-supply = "vddio-pex-ctl";
     regulator-consumer-device = "pcie-controller.3";
    };
    c18 {
     regulator-consumer-supply = "vdd33a";
    };
    c19 {
     regulator-consumer-supply = "vddvario";
    };
    c20 {
     regulator-consumer-supply = "avdd_usb";
     regulator-consumer-device = "tegra-udc.0";
    };
    c21 {
     regulator-consumer-supply = "vddio_sdmmc";
     regulator-consumer-device = "sdhci-tegra.3";
    };
    c22 {
     regulator-consumer-supply = "vddio_sd_slot";
     regulator-consumer-device = "sdhci-tegra.3";
    };
    c23 {
     regulator-consumer-supply = "vqmmc";
     regulator-consumer-device = "sdhci-tegra.3";
    };
    c24 {
     regulator-consumer-supply = "vmmc";
     regulator-consumer-device = "sdhci-tegra.3";
    };
    c25 {
     regulator-consumer-supply = "vddio_sd_slot";
     regulator-consumer-device = "sdhci-tegra.2";
    };
    c26 {
     regulator-consumer-supply = "vqmmc";
     regulator-consumer-device = "sdhci-tegra.2";
    };
    c27 {
     regulator-consumer-supply = "vmmc";
     regulator-consumer-device = "sdhci-tegra.2";
    };
    c28 {
     regulator-consumer-supply = "vddio_sdmmc";
     regulator-consumer-device = "sdhci-tegra.1";
    };
    c29 {
     regulator-consumer-supply = "vddio_sd_slot";
     regulator-consumer-device = "sdhci-tegra.1";
    };
    c30 {
     regulator-consumer-supply = "vqmmc";
     regulator-consumer-device = "sdhci-tegra.1";
    };
    c31 {
     regulator-consumer-supply = "vmmc";
     regulator-consumer-device = "sdhci-tegra.1";
    };
    c32 {
     regulator-consumer-supply = "vdd_core";
    };
   };
  };


  max77620: gpu_max77621_reg: cpu_max77621_reg: en_vdd_cpu_fixed: regulator@1 {
   compatible = "regulator-fixed";
   reg = <1>;
   regulator-name = "vdd_cpu_fixed";
   regulator-min-microvolt = <1000000>;
   regulator-max-microvolt = <1000000>;
  };

  max77620_sd0: regulator@2 {
   compatible = "regulator-fixed";
   reg = <2>;
   regulator-name = "vdd_core_fixed";
   regulator-min-microvolt = <1000000>;
   regulator-max-microvolt = <1000000>;
  };
 };

 gpio_regulator: gpio-regulator {
  compatible = "regulator-gpio";
  regulator-name = "vddio-sdmmc";
  regulator-type = "voltage";
  regulator-min-microvolt = <1800000>;
  regulator-max-microvolt = <3300000>;

  gpios = <&gpio ((25 * 8) + 4) 0>;
  states = <1800000 0x0
   3300000 0x1>;
  enable-active-high;
 };
};
# 27 "arch/arm64/boot/dts/tegra210-grenada.dts" 2
# 1 "arch/arm64/boot/dts/tegra210-platforms/tegra210-ers-power-dvfs-e2174-1101-a00.dtsi" 1
# 18 "arch/arm64/boot/dts/tegra210-platforms/tegra210-ers-power-dvfs-e2174-1101-a00.dtsi"
/ {
 dfll-ovr@70110000 {
  status = "okay";
  compatible = "nvidia,tegra210-dfll";
  reg = <0x0 0x70110000 0x0 0x400>;
  out-clock-name="dfll_cpu";
  clocks = <&tegra_car 280>,
    <&tegra_car 155>,
    <&tegra_car 281>,
    <&tegra_car 353>,
    <&tegra_car 47>;
  clock-names = "dfll_cpu", "soc", "ref", "safe_dvfs", "i2c";
  calibrate-force-vmin;
  board-params = <&dfll_ovr_params>;

  pwm_dfll: pwm-pmic-integration {
   compatible = "nvidia,tegra210-dfll-pwm";
   pwm-1wire-direct;
   pwm-data-gpio = <&gpio ((27 * 8) + 1) 0>;
   #pwm-cells = <2>;
   pwm-regulator = <&cpu_ovr_reg>;
  };

  dfll_ovr_params: dfll-ovr-board-params {
   sample-rate = <25000>;
   fixed-output-forcing;
   cf = <6>;
   ci = <0>;
   cg = <2>;
   droop-cut-value = <0xf>;
   droop-restore-ramp = <0x0>;
   scale-out-ramp = <0x0>;
  };
 };

 dfll-max77621@70110000 {
  status = "disabled";
  compatible = "nvidia,tegra210-dfll";
  reg = <0x0 0x70110000 0x0 0x400>;
  out-clock-name="dfll_cpu";
  clocks = <&tegra_car 280>,
    <&tegra_car 155>,
    <&tegra_car 281>,
    <&tegra_car 353>,
    <&tegra_car 47>;
  clock-names = "dfll_cpu", "soc", "ref", "safe_dvfs", "i2c";
  board-params = <&dfll_max77621_parms>;
  i2c-pmic-integration = <&i2c_dfll>;

  i2c_dfll: dfll-max77621-integration {
   pmic-i2c-address = <0x36>;
   pmic-i2c-voltage-register = <0x01>;
   i2c-fs-rate = <400000>;
   sel-conversion-slope = <1>;
  };

  dfll_max77621_parms: dfll-max77621-board-params {
   sample-rate = <12500>;
   fixed-output-forcing;
   cf = <10>;
   ci = <0>;
   cg = <2>;
   droop-cut-value = <0xf>;
   droop-restore-ramp = <0x0>;
   scale-out-ramp = <0x0>;
  };
 };


 pwm_regulators {
  compatible = "simple-bus";
  #address-cells = <1>;
  #size-cells = <0>;

  cpu_ovr_reg: pwm-regulator@0 {
   status = "okay";
   reg = <0>;
   compatible = "regulator-pwm";
   pwms = <&pwm_dfll 0 2500>;
   regulator-name = "vdd_cpu";
   regulator-min-microvolt = <708000>;
   regulator-max-microvolt = <1322400>;
   regulator-init-microvolt = <1000000>;
   regulator-always-on;
   regulator-boot-on;
   regulator-n-voltages = <33>;
   voltage-time-sel = <80>;
  };

  gpu_ovr_reg: pwm-regulator@1 {
   status = "okay";
   reg = <1>;
   compatible = "regulator-pwm";
   pwms = <&tegra_pwm 1 4880>;
   regulator-name = "vdd_gpu";
   regulator-min-microvolt = <710000>;
   regulator-max-microvolt = <1320000>;
   regulator-init-microvolt = <1000000>;
   regulator-n-voltages = <62>;
   regulator-enable-ramp-delay = <1000>;
   enable-gpio = <&max77620 6 0>;
   voltage-time-sel = <80>;
  };
 };

 cpu_edp {
  status = "okay";
  nvidia,edp_limit = <25000>;
 };

 gpu_edp {
  status = "okay";
  nvidia,edp_limit = <20000>;
 };

 dvfs_rails {
  vdd-cpu-rail-ovr@0 {
   status = "okay";
   reg = <0>;
   compatible = "nvidia,tegra210-dvfs-rail";
   vdd_cpu-supply = <&cpu_ovr_reg>;
   vmin-cdev = <&cpu_vmin_cdev>;
   vmax-cdev = <&cpu_vmax_cdev>;
  };

  vdd-gpu-rail-ovr@1 {
   status = "okay";
   reg = <1>;
   compatible = "nvidia,tegra210-dvfs-rail";
   vdd_gpu-supply = <&gpu_ovr_reg>;
   scaling-cdev = <&gpu_scaling_cdev>;
   vmax-cdev = <&gpu_vmax_cdev>;
  };


  vdd-cpu-rail-max77621@2 {
   status = "disabled";
   reg = <2>;
   compatible = "nvidia,tegra210-dvfs-rail";
   vdd_cpu-supply = <&cpu_max77621_reg>;
   vmin-cdev = <&cpu_vmin_cdev>;
   vmax-cdev = <&cpu_vmax_cdev>;
  };

  vdd-gpu-rail-max77621@3 {
   status = "disabled";
   reg = <3>;
   compatible = "nvidia,tegra210-dvfs-rail";
   vdd_gpu-supply = <&gpu_max77621_reg>;
   scaling-cdev = <&gpu_scaling_cdev>;
   vmax-cdev = <&gpu_vmax_cdev>;
  };

  vdd-core-rail-max77620@4 {
   status = "okay";
   reg = <4>;
   compatible = "nvidia,tegra210-dvfs-rail";
   vdd_core-supply = <&max77620_sd0>;
   vmin-cdev = <&core_vmin_cdev>;
   vmax-cdev = <&core_vmax_cdev>;
  };
 };
};

# 1 "arch/arm64/boot/dts/tegra210-platforms/tegra210-power-dvfs.dtsi" 1
# 30 "arch/arm64/boot/dts/tegra210-platforms/tegra210-power-dvfs.dtsi"
/ {
 dvfs_rails {
  compatible = "simple-bus";
  #address-cells = <1>;
  #size-cells = <0>;

  cpu_vmin_cdev: vdd-cpu-vmin-cdev@5 {
   status = "disabled";
   reg = <5>;
   cooling-min-state = <0>;
   cooling-max-state = <1>;
   #cooling-cells = <2>;
   compatible = "nvidia,tegra210-rail-vmin-cdev";
   cdev-type = "cpu_cold";
   nvidia,constraint;
   nvidia,trips = <&cpu_vmin1 950>;
  };

  core_vmin_cdev: vdd-core-vmin-cdev@6 {
   status = "disabled";
   reg = <6>;
   cooling-min-state = <0>;
   cooling-max-state = <1>;
   #cooling-cells = <2>;
   compatible = "nvidia,tegra210-rail-vmin-cdev";
   cdev-type = "core_cold";
   nvidia,constraint;
   nvidia,trips = <&core_vmin1 950>;
  };

  gpu_scaling_cdev: vdd-gpu-scaling-cdev@7 {
   status = "disabled";
   reg = <7>;
   cooling-min-state = <0>;
   cooling-max-state = <5>;
   #cooling-cells = <2>;
   compatible = "nvidia,tegra210-rail-scaling-cdev";
   cdev-type = "gpu_scaling";
   nvidia,constraint;
   nvidia,trips = <&gpu_scaling0 950 &gpu_scaling1 0
     &gpu_scaling2 0 &gpu_scaling3 0
     &gpu_scaling4 0 &gpu_scaling5 0>;
  };

  cpu_vmax_cdev: vdd-cpu-vmax-cdev@8 {
   status = "disabled";
   reg = <8>;
   cooling-min-state = <0>;
   cooling-max-state = <1>;
   #cooling-cells = <2>;
   compatible = "nvidia,tegra210-rail-vmax-cdev";
   cdev-type = "cpu_hot";
   nvidia,constraint;
   nvidia,trips = <&cpu_vmax1 1170 &cpu_vmax2 1132>;
  };

  gpu_vmax_cdev: vdd-gpu-vmax-cdev@9 {
   status = "disabled";
   reg = <9>;
   cooling-min-state = <0>;
   cooling-max-state = <1>;
   #cooling-cells = <2>;
   compatible = "nvidia,tegra210-rail-vmax-cdev";
   cdev-type = "gpu_hot";
   nvidia,constraint;
   nvidia,trips = <&gpu_vmax1 1132>;
  };

  core_vmax_cdev: vdd-core-vmax-cdev@10 {
   status = "disabled";
   reg = <10>;
   cooling-min-state = <0>;
   cooling-max-state = <1>;
   #cooling-cells = <2>;
   compatible = "nvidia,tegra210-rail-vmax-cdev";
   cdev-type = "core_hot";
   nvidia,constraint;
   nvidia,trips = <&core_vmax1 1132>;
  };
 };

 thermal-zones {
  Tdiode_tegra {
   trips { cpu_vmin1: cpu-vmin1 { temperature = <15000>; hysteresis = <1000>; type = "active"; }; }; cooling-maps { cpu-vmin-map1 { trip = <&cpu_vmin1>; cooling-device = <&cpu_vmin_cdev 1 1>; }; };
  };
  Tdiode_tegra {
   trips {

    gpu_scaling0: gpu-scaling0 {
     temperature = <(-25000)>;
     hysteresis = <0>;
     type = "active";
    };
   };
   trips { gpu_scaling1: gpu-scaling1 { temperature = <15000>; hysteresis = <1000>; type = "active"; }; }; cooling-maps { gpu-scaling-map1 { trip = <&gpu_scaling1>; cooling-device = <&gpu_scaling_cdev 1 1>; }; };
   trips { gpu_scaling2: gpu-scaling2 { temperature = <30000>; hysteresis = <1000>; type = "active"; }; }; cooling-maps { gpu-scaling-map2 { trip = <&gpu_scaling2>; cooling-device = <&gpu_scaling_cdev 2 2>; }; };
   trips { gpu_scaling3: gpu-scaling3 { temperature = <50000>; hysteresis = <1000>; type = "active"; }; }; cooling-maps { gpu-scaling-map3 { trip = <&gpu_scaling3>; cooling-device = <&gpu_scaling_cdev 3 3>; }; };
   trips { gpu_scaling4: gpu-scaling4 { temperature = <70000>; hysteresis = <1000>; type = "active"; }; }; cooling-maps { gpu-scaling-map4 { trip = <&gpu_scaling4>; cooling-device = <&gpu_scaling_cdev 4 4>; }; };
   trips { gpu_scaling5: gpu-scaling5 { temperature = <105000>; hysteresis = <1000>; type = "active"; }; }; cooling-maps { gpu-scaling-map5 { trip = <&gpu_scaling5>; cooling-device = <&gpu_scaling_cdev 5 5>; }; };

   trips { gpu_vmax1: gpu-vmax1 { temperature = <83000>; hysteresis = <1000>; type = "active"; }; }; cooling-maps { gpu-vmax-map1 { trip = <&gpu_vmax1>; cooling-device = <&gpu_vmax_cdev 1 1>; }; };
  };
  Tdiode_tegra {
   trips { core_vmin1: core-vmin1 { temperature = <15000>; hysteresis = <1000>; type = "active"; }; }; cooling-maps { core-vmin-map1 { trip = <&core_vmin1>; cooling-device = <&core_vmin_cdev 1 1>; }; };
   trips { core_vmax1: core-vmax1 { temperature = <86000>; hysteresis = <1000>; type = "active"; }; }; cooling-maps { core-vmax-map1 { trip = <&core_vmax1>; cooling-device = <&core_vmax_cdev 1 1>; }; };
  };
  CPU-therm {
   trips { cpu_vmax1: cpu-vmax1 { temperature = <66000>; hysteresis = <1000>; type = "active"; }; }; cooling-maps { cpu-vmax-map1 { trip = <&cpu_vmax1>; cooling-device = <&cpu_vmax_cdev 1 1>; }; };
   trips { cpu_vmax2: cpu-vmax2 { temperature = <86000>; hysteresis = <1000>; type = "active"; }; }; cooling-maps { cpu-vmax-map2 { trip = <&cpu_vmax2>; cooling-device = <&cpu_vmax_cdev 2 2>; }; };
  };
  LCPU-therm {
   trips { lcpu_vmax1: lcpu-vmax1 { temperature = <66000>; hysteresis = <1000>; type = "active"; }; }; cooling-maps { lcpu-vmax-map1 { trip = <&lcpu_vmax1>; cooling-device = <&cpu_vmax_cdev 1 1>; }; };
   trips { lcpu_vmax2: lcpu-vmax2 { temperature = <86000>; hysteresis = <1000>; type = "active"; }; }; cooling-maps { lcpu-vmax-map2 { trip = <&lcpu_vmax2>; cooling-device = <&cpu_vmax_cdev 2 2>; }; };
  };
 };
};
# 183 "arch/arm64/boot/dts/tegra210-platforms/tegra210-ers-power-dvfs-e2174-1101-a00.dtsi" 2

/ {
 dvfs_rails {
  vdd-cpu-vmin-cdev@5 {
   status = "okay";
  };

  vdd-core-vmin-cdev@6 {
   status = "okay";
  };

  vdd-gpu-scaling-cdev@7 {
   status = "okay";
  };

  vdd-cpu-vmax-cdev@8 {
   status = "okay";
  };

  vdd-gpu-vmax-cdev@9 {
   status = "okay";
  };

  vdd-core-vmax-cdev@10 {
   status = "okay";
  };
 };
};
# 28 "arch/arm64/boot/dts/tegra210-grenada.dts" 2
# 1 "/home/mosaic/kernel/JetPack_5.26.16b/TX1/Linux_for_Tegra_tx1/sources/kernel_source/arch/arm64/boot/dts/include/dt-bindings/pinctrl/pinctrl-tegra.h" 1
# 29 "arch/arm64/boot/dts/tegra210-grenada.dts" 2

# 1 "/home/mosaic/kernel/JetPack_5.26.16b/TX1/Linux_for_Tegra_tx1/sources/kernel_source/arch/arm64/boot/dts/include/dt-bindings/sound/tegra-asoc-alt.h" 1
# 31 "arch/arm64/boot/dts/tegra210-grenada.dts" 2

/ {
 model = "grenada";
 compatible = "nvidia,grenada", "nvidia,tegra210";
 nvidia,dtsfilename = "arch/arm64/boot/dts/tegra210-grenada.dts";
 nvidia,dtbbuildtime = "May 31 2016", "09:33:17";

 chosen {
  bootargs ="mem=1024M@2048M console=ttyS0,115200 earlyprintk=uart8250-32bit,0x70006000";
        };



 firmware {
  android {
   compatible = "android,firmware";
   hardware = "grenada";
  };
 };

 memory@80000000 {
  device_type = "memory";
  reg = < 0x0 0x80000000 0x0 0x40000000 >;
 };

 i2c@7000c000 {
  rt5639: rt5639.0-001c@1c {
   compatible = "realtek,rt5639";
   reg = <0x1c>;
  };
 };

 adma@702e2000 {
  interrupts = <0 24 0x04
         0 25 0x04
         0 26 0x04
         0 27 0x04
         0 28 0x04
         0 29 0x04
         0 30 0x04
         0 31 0x04
         0 32 0x04
         0 33 0x04>;
  dma-channels = <10>;
  status = "disabled";
 };

 spi@7000d600 {
  status = "okay";
  spi-max-frequency = <25000000>;
 };

 spi@70410000 {
  status = "okay";
  spi@0 {
   compatible = "spidev";
   reg = <0>;
   spi-max-frequency = <13000000>;

   controller-data {
    nvidia,x1-len-limit = <16>;
    nvidia,x1-bus-speed = <50>;
    nvidia,x1-dymmy-cycle = <0>;
    nvidia,x4-bus-speed = <80>;
    nvidia,x4-dymmy-cycle = <8>;
   };

  };
 };

 serial@70006000 {
  compatible = "nvidia,tegra210-uart";
  console-port;
  status = "okay";
 };

 serial@70006040 {
  compatible = "nvidia,tegra210-uart";
  status = "okay";
 };

 serial@70006200 {
  compatible = "nvidia,tegra210-uart";
  status = "okay";
 };

 pinmux@700008d4 {
  pinctrl-names = "default";
  pinctrl-0 = <&pinmux_default>;

  pinmux_default: common {
   dvfs_pwm_pbb1 {
    nvidia,pins = "dvfs_pwm_pbb1";
    nvidia,function = "cldvfs";
    nvidia,enable-input = <0>;
    nvidia,pull = <0>;
    nvidia,tristate = <1>;
   };

   dvfs_clk_pbb2 {
    nvidia,pins = "dvfs_clk_pbb2";
    nvidia,function = "cldvfs";
    nvidia,enable-input = <0>;
    nvidia,pull = <0>;
    nvidia,tristate = <0>;
   };

   gen2_i2c_scl_pj2 {
    nvidia,pins = "gen2_i2c_scl_pj2";
    nvidia,function = "i2c2";
    nvidia,enable-input = <1>;
    nvidia,pull = <0>;
    nvidia,tristate = <0>;
    nvidia,lock = <0>;
    nvidia,open-drain = <0>;
   };

   gen2_i2c_sda_pj3 {
    nvidia,pins = "gen2_i2c_sda_pj3";
    nvidia,function = "i2c2";
    nvidia,enable-input = <1>;
    nvidia,pull = <0>;
    nvidia,tristate = <0>;
    nvidia,lock = <0>;
    nvidia,open-drain = <0>;
   };

   sdmmc1_clk_pm0 {
    nvidia,pins = "sdmmc1_clk_pm0";
    nvidia,function = "sdmmc1";
    nvidia,enable-input = <1>;
    nvidia,pull = <0>;
    nvidia,tristate = <0>;
   };

   sdmmc1_cmd_pm1 {
    nvidia,pins = "sdmmc1_cmd_pm1";
    nvidia,function = "sdmmc1";
    nvidia,enable-input = <1>;
    nvidia,pull = <2>;
    nvidia,tristate = <0>;
   };

   sdmmc1_dat0_pm5 {
    nvidia,pins = "sdmmc1_dat0_pm5";
    nvidia,function = "sdmmc1";
    nvidia,enable-input = <1>;
    nvidia,pull = <2>;
    nvidia,tristate = <0>;
   };

   sdmmc1_dat1_pm4 {
    nvidia,pins = "sdmmc1_dat1_pm4";
    nvidia,function = "sdmmc1";
    nvidia,enable-input = <1>;
    nvidia,pull = <2>;
    nvidia,tristate = <0>;
   };

   sdmmc1_dat2_pm3 {
    nvidia,pins = "sdmmc1_dat2_pm3";
    nvidia,function = "sdmmc1";
    nvidia,enable-input = <1>;
    nvidia,pull = <2>;
    nvidia,tristate = <0>;
   };

   sdmmc1_dat3_pm2 {
    nvidia,pins = "sdmmc1_dat3_pm2";
    nvidia,function = "sdmmc1";
    nvidia,enable-input = <1>;
    nvidia,pull = <2>;
    nvidia,tristate = <0>;
   };

   sdmmc3_clk_pp0 {
    nvidia,pins = "sdmmc3_clk_pp0";
    nvidia,function = "sdmmc3";
    nvidia,enable-input = <1>;
    nvidia,pull = <0>;
    nvidia,tristate = <0>;
   };

   sdmmc3_cmd_pp1 {
    nvidia,pins = "sdmmc3_cmd_pp1";
    nvidia,function = "sdmmc3";
    nvidia,enable-input = <1>;
    nvidia,pull = <2>;
    nvidia,tristate = <0>;
   };

   sdmmc3_dat0_pp5 {
    nvidia,pins = "sdmmc3_dat0_pp5";
    nvidia,function = "sdmmc3";
    nvidia,enable-input = <1>;
    nvidia,pull = <2>;
    nvidia,tristate = <0>;
   };

   sdmmc3_dat1_pp4 {
    nvidia,pins = "sdmmc3_dat1_pp4";
    nvidia,function = "sdmmc3";
    nvidia,enable-input = <1>;
    nvidia,pull = <2>;
    nvidia,tristate = <0>;
   };

   sdmmc3_dat2_pp3 {
    nvidia,pins = "sdmmc3_dat2_pp3";
    nvidia,function = "sdmmc3";
    nvidia,enable-input = <1>;
    nvidia,pull = <2>;
    nvidia,tristate = <0>;
   };

   sdmmc3_dat3_pp2 {
    nvidia,pins = "sdmmc3_dat3_pp2";
    nvidia,function = "sdmmc3";
    nvidia,enable-input = <1>;
    nvidia,pull = <2>;
    nvidia,tristate = <0>;
   };

   pwr_i2c_scl_py3 {
    nvidia,pins = "pwr_i2c_scl_py3";
    nvidia,function = "i2cpmu";
    nvidia,enable-input = <1>;
    nvidia,pull = <0>;
    nvidia,tristate = <0>;
    nvidia,open-drain = <0>;
   };

   pwr_i2c_sda_py4 {
    nvidia,pins = "pwr_i2c_sda_py4";
    nvidia,function = "i2cpmu";
    nvidia,enable-input = <1>;
    nvidia,pull = <0>;
    nvidia,tristate = <0>;
    nvidia,open-drain = <0>;
   };

   clk_32k_in {
    nvidia,pins = "clk_32k_in";
    nvidia,function = "clk";
    nvidia,enable-input = <1>;
    nvidia,pull = <0>;
    nvidia,tristate = <0>;
   };

   gen1_i2c_sda_pj0 {
    nvidia,pins = "gen1_i2c_sda_pj0";
    nvidia,function = "i2c1";
    nvidia,enable-input = <1>;
    nvidia,pull = <0>;
    nvidia,tristate = <0>;
    nvidia,lock = <0>;
    nvidia,open-drain = <0>;
   };

   gen1_i2c_scl_pj1 {
    nvidia,pins = "gen1_i2c_scl_pj1";
    nvidia,function = "i2c1";
    nvidia,enable-input = <1>;
    nvidia,pull = <0>;
    nvidia,tristate = <0>;
    nvidia,lock = <0>;
    nvidia,open-drain = <0>;
   };

   uart2_cts_pg3 {
    nvidia,pins = "uart2_cts_pg3";
    nvidia,function = "uartb";
    nvidia,enable-input = <1>;
    nvidia,pull = <0>;
    nvidia,tristate = <0>;
   };

   uart2_rts_pg2 {
    nvidia,pins = "uart2_rts_pg2";
    nvidia,function = "uartb";
    nvidia,enable-input = <0>;
    nvidia,pull = <0>;
    nvidia,tristate = <0>;
   };

   uart2_rx_pg1 {
    nvidia,pins = "uart2_rx_pg1";
    nvidia,function = "uartb";
    nvidia,enable-input = <1>;
    nvidia,pull = <0>;
    nvidia,tristate = <0>;
   };

   uart2_tx_pg0 {
    nvidia,pins = "uart2_tx_pg0";
    nvidia,function = "uartb";
    nvidia,enable-input = <0>;
    nvidia,pull = <0>;
    nvidia,tristate = <0>;
   };

   uart3_cts_pd4 {
    nvidia,pins = "uart3_cts_pd4";
    nvidia,function = "uartc";
    nvidia,enable-input = <1>;
    nvidia,pull = <0>;
    nvidia,tristate = <0>;
   };

   uart3_rts_pd3 {
    nvidia,pins = "uart3_rts_pd3";
    nvidia,function = "uartc";
    nvidia,enable-input = <0>;
    nvidia,pull = <0>;
    nvidia,tristate = <0>;
   };

   uart3_rx_pd2 {
    nvidia,pins = "uart3_rx_pd2";
    nvidia,function = "uartc";
    nvidia,enable-input = <1>;
    nvidia,pull = <0>;
    nvidia,tristate = <0>;
   };

   uart3_tx_pd1 {
    nvidia,pins = "uart3_tx_pd1";
    nvidia,function = "uartc";
    nvidia,enable-input = <0>;
    nvidia,pull = <0>;
    nvidia,tristate = <0>;
   };

   uart4_cts_pi7 {
    nvidia,pins = "uart4_cts_pi7";
    nvidia,function = "uart";
    nvidia,enable-input = <1>;
    nvidia,pull = <0>;
    nvidia,tristate = <0>;
   };

   uart4_rts_pi6 {
    nvidia,pins = "uart4_rts_pi6";
    nvidia,function = "uart";
    nvidia,enable-input = <0>;
    nvidia,pull = <0>;
    nvidia,tristate = <0>;
   };

   uart4_rx_pi5 {
    nvidia,pins = "uart4_rx_pi5";
    nvidia,function = "uart";
    nvidia,enable-input = <1>;
    nvidia,pull = <0>;
    nvidia,tristate = <0>;
   };

   uart4_tx_pi4 {
    nvidia,pins = "uart4_tx_pi4";
    nvidia,function = "uart";
    nvidia,enable-input = <0>;
    nvidia,pull = <0>;
    nvidia,tristate = <0>;
   };

   gpio_x1_aud_pbb3 {
    nvidia,pins = "gpio_x1_aud_pbb3";
    nvidia,function = "rsvd1";
    nvidia,enable-input = <0>;
    nvidia,pull = <0>;
    nvidia,tristate = <0>;
   };

   gpio_x3_aud_pbb4 {
    nvidia,pins = "gpio_x3_aud_pbb4";
    nvidia,function = "rsvd1";
    nvidia,enable-input = <1>;
    nvidia,pull = <2>;
    nvidia,tristate = <0>;
   };

   qspi_sck_pee0 {
    nvidia,pins = "qspi_sck_pee0";
    nvidia,function = "qspi";
    nvidia,enable-input = <1>;
    nvidia,pull = <2>;
    nvidia,tristate = <0>;
   };

   pz4 {
    nvidia,pins = "pz4";
    nvidia,function = "rsvd2";
    nvidia,enable-input = <0>;
    nvidia,pull = <2>;
    nvidia,tristate = <0>;
   };

   qspi_cs_n_pee1 {
    nvidia,pins = "qspi_cs_n_pee1";
    nvidia,function = "qspi";
    nvidia,enable-input = <1>;
    nvidia,pull = <2>;
    nvidia,tristate = <0>;
   };

   qspi_io0_pee2 {
    nvidia,pins = "qspi_io0_pee2";
    nvidia,function = "qspi";
    nvidia,enable-input = <1>;
    nvidia,pull = <2>;
    nvidia,tristate = <0>;
   };

   qspi_io1_pee3 {
    nvidia,pins = "qspi_io1_pee3";
    nvidia,function = "qspi";
    nvidia,enable-input = <1>;
    nvidia,pull = <2>;
    nvidia,tristate = <0>;
   };

   qspi_io2_pee4 {
    nvidia,pins = "qspi_io2_pee4";
    nvidia,function = "qspi";
    nvidia,enable-input = <1>;
    nvidia,pull = <2>;
    nvidia,tristate = <0>;
   };

   qspi_io3_pee5 {
    nvidia,pins = "qspi_io3_pee5";
    nvidia,function = "qspi";
    nvidia,enable-input = <1>;
    nvidia,pull = <2>;
    nvidia,tristate = <0>;
   };

   spi1_mosi_pc0 {
    nvidia,pins = "spi1_mosi_pc0";
    nvidia,function = "spi1";
    nvidia,enable-input = <1>;
    nvidia,pull = <1>;
    nvidia,tristate = <1>;
   };

   spi1_miso_pc1 {
    nvidia,pins = "spi1_miso_pc1";
    nvidia,function = "spi1";
    nvidia,enable-input = <1>;
    nvidia,pull = <1>;
    nvidia,tristate = <1>;
   };

   spi1_sck_pc2 {
    nvidia,pins = "spi1_sck_pc2";
    nvidia,function = "spi1";
    nvidia,enable-input = <1>;
    nvidia,pull = <1>;
    nvidia,tristate = <1>;
   };

   spi1_cs0_pc3 {
    nvidia,pins = "spi1_cs0_pc3";
    nvidia,function = "spi1";
    nvidia,enable-input = <1>;
    nvidia,pull = <2>;
    nvidia,tristate = <1>;
   };

   spi4_sck_pc5 {
    nvidia,pins = "spi4_sck_pc5";
    nvidia,function = "spi4";
    nvidia,enable-input = <1>;
    nvidia,pull = <1>;
    nvidia,tristate = <1>;
   };

   spi4_cs0_pc6 {
    nvidia,pins = "spi4_cs0_pc6";
    nvidia,function = "spi4";
    nvidia,enable-input = <1>;
    nvidia,pull = <2>;
    nvidia,tristate = <1>;
   };

   spi4_mosi_pc7 {
    nvidia,pins = "spi4_mosi_pc7";
    nvidia,function = "spi4";
    nvidia,enable-input = <1>;
    nvidia,pull = <1>;
    nvidia,tristate = <1>;
   };

   spi4_miso_pd0 {
    nvidia,pins = "spi4_miso_pd0";
    nvidia,function = "spi4";
    nvidia,enable-input = <1>;
    nvidia,pull = <1>;
    nvidia,tristate = <1>;
   };

   gen3_i2c_scl_pf0 {
    nvidia,pins = "gen3_i2c_scl_pf0";
    nvidia,function = "i2c3";
    nvidia,enable-input = <1>;
    nvidia,pull = <0>;
    nvidia,tristate = <0>;
    nvidia,lock = <0>;
    nvidia,open-drain = <0>;
   };

   gen3_i2c_sda_pf1 {
    nvidia,pins = "gen3_i2c_sda_pf1";
    nvidia,function = "i2c3";
    nvidia,enable-input = <1>;
    nvidia,pull = <0>;
    nvidia,tristate = <0>;
    nvidia,lock = <0>;
    nvidia,open-drain = <0>;
   };

   uart1_tx_pu0 {
    nvidia,pins = "uart1_tx_pu0";
    nvidia,function = "uarta";
    nvidia,enable-input = <0>;
    nvidia,pull = <1>;
    nvidia,tristate = <0>;
   };

   uart1_rx_pu1 {
    nvidia,pins = "uart1_rx_pu1";
    nvidia,function = "uarta";
    nvidia,enable-input = <1>;
    nvidia,pull = <1>;
    nvidia,tristate = <0>;
   };

   uart1_rts_pu2 {
    nvidia,pins = "uart1_rts_pu2";
    nvidia,function = "uarta";
    nvidia,enable-input = <0>;
    nvidia,pull = <1>;
    nvidia,tristate = <0>;
   };

   uart1_cts_pu3 {
    nvidia,pins = "uart1_cts_pu3";
    nvidia,function = "uarta";
    nvidia,enable-input = <1>;
    nvidia,pull = <1>;
    nvidia,tristate = <0>;
   };

   spi2_mosi_pb4 {
    nvidia,pins = "spi2_mosi_pb4";
    nvidia,function = "spi2";
    nvidia,enable-input = <1>;
    nvidia,pull = <2>;
    nvidia,tristate = <0>;
   };

   spi2_miso_pb5 {
    nvidia,pins = "spi2_miso_pb5";
    nvidia,function = "spi2";
    nvidia,enable-input = <1>;
    nvidia,pull = <2>;
    nvidia,tristate = <0>;
   };

   spi2_sck_pb6 {
    nvidia,pins = "spi2_sck_pb6";
    nvidia,function = "spi2";
    nvidia,enable-input = <1>;
    nvidia,pull = <2>;
    nvidia,tristate = <0>;
   };

   spi2_cs0_pb7 {
    nvidia,pins = "spi2_cs0_pb7";
    nvidia,function = "spi2";
    nvidia,enable-input = <1>;
    nvidia,pull = <2>;
    nvidia,tristate = <0>;
   };

   spi2_cs1_pdd0 {
    nvidia,pins = "spi2_cs1_pdd0";
    nvidia,function = "spi2";
    nvidia,enable-input = <1>;
    nvidia,pull = <2>;
    nvidia,tristate = <1>;
   };
  };

  dap1_active_state: dap1_active {
   i2s1 {
    nvidia,pins = "dap1_fs_pb0", "dap1_din_pb1",
        "dap1_dout_pb2","dap1_sclk_pb3";
    nvidia,function = "i2s1";
    nvidia,enable-input = <1>;
    nvidia,pull = <0>;
    nvidia,tristate = <0>;
   };
  };

  dap1_inactive_state: dap1_inactive {
   i2s1 {
    nvidia,pins = "dap1_fs_pb0", "dap1_din_pb1",
        "dap1_dout_pb2", "dap1_sclk_pb3";
    nvidia,function = "i2s1";
    nvidia,enable-input = <0>;
    nvidia,pull = <0>;
    nvidia,tristate = <1>;
   };
  };

  dap2_active_state: dap2_active {
   i2s2 {
    nvidia,pins = "dap2_fs_paa0","dap2_din_paa2",
        "dap2_dout_paa3","dap2_sclk_paa1";
    nvidia,function = "i2s2";
    nvidia,enable-input = <1>;
    nvidia,pull = <0>;
    nvidia,tristate = <0>;
   };
  };


  dap2_inactive_state: dap2_inactive {
   i2s2 {
    nvidia,pins = "dap2_fs_paa0","dap2_din_paa2",
        "dap2_dout_paa3","dap2_sclk_paa1";
    nvidia,function = "i2s2";
    nvidia,enable-input = <0>;
    nvidia,pull = <0>;
    nvidia,tristate = <1>;
   };
  };

  dap4_active_state: dap4_active {
   i2s4 {
    nvidia,pins = "dap4_fs_pj4", "dap4_din_pj5",
        "dap4_dout_pj6", "dap4_sclk_pj7";
    nvidia,function = "i2s4b";
    nvidia,enable-input = <1>;
    nvidia,pull = <0>;
    nvidia,tristate = <0>;
   };
  };

  dap4_inactive_state: dap4_inactive {
   i2s4 {
    nvidia,pins = "dap4_fs_pj4", "dap4_din_pj5",
        "dap4_dout_pj6", "dap4_sclk_pj7";
    nvidia,function = "i2s4b";
    nvidia,enable-input = <0>;
    nvidia,pull = <0>;
    nvidia,tristate = <1>;
   };
  };

  dap5_active_state: dap5_active {
   i2s5 {
    nvidia,pins = "pk0","pk1","pk2","pk3";
    nvidia,function = "i2s5";
    nvidia,enable-input = <1>;
    nvidia,pull = <0>;
    nvidia,tristate = <0>;
   };
  };

  dap5_inactive_state: dap5_inactive {
   i2s5 {
    nvidia,pins = "pk0","pk1","pk2","pk3";
    nvidia,function = "i2s5";
    nvidia,enable-input = <0>;
    nvidia,pull = <0>;
    nvidia,tristate = <1>;
   };
  };
 };

 ahub {
  status = "disabled";

  admaif@0x702d0000 {
   status = "okay";
  };

  sfc@702d2000 {
   status = "okay";
  };

  sfc@702d2200 {
   status = "okay";
  };

  sfc@702d2400 {
   status = "okay";
  };

  sfc@702d2600 {
   status = "okay";
  };

  spkprot@702d8c00 {
   status = "okay";
  };

  mvc@702da000 {
   status = "okay";
  };

  mvc@0x702da200 {
   status = "okay";
  };

  amixer@702dbb00 {
   status = "okay";
  };

  i2s@702d1000 {
   pinctrl-names = "dap_active", "dap_inactive";
   pinctrl-0 = <>;
   pinctrl-1 = <>;
   status = "okay";
  };

  i2s@702d1100 {
   pinctrl-names = "dap_active", "dap_inactive";
   pinctrl-0 = <>;
   pinctrl-1 = <>;
   status = "okay";
  };

  i2s@702d1200 {
   pinctrl-names = "dap_active", "dap_inactive";
   pinctrl-0 = <>;
   pinctrl-1 = <>;
   status = "okay";
  };

  i2s@702d1300 {
   pinctrl-names = "dap_active", "dap_inactive";
   pinctrl-0 = <>;
   pinctrl-1 = <>;
   status = "okay";
  };

  i2s@702d1400 {
   pinctrl-names = "dap_active", "dap_inactive";
   pinctrl-0 = <>;
   pinctrl-1 = <>;
   status = "okay";
  };

  dmic@702d4000 {
   status = "okay";
  };

  dmic@702d4100 {
   status = "okay";
  };

  dmic@702d4200 {
   status = "okay";
  };

  amx@702d3000 {
   status = "okay";
  };

  amx@702d3100 {
   status = "okay";
  };

  adx@702d3800 {
   status = "okay";
  };

  adx@702d3900 {
   status = "okay";
  };

  afc@702d7000 {
   status = "okay";
  };

  afc@702d7100 {
   status = "okay";
  };

  afc@702d7200 {
   status = "okay";
  };

  afc@702d7300 {
   status = "okay";
  };

  afc@702d7400 {
   status = "okay";
  };

  afc@702d7500 {
   status = "okay";
  };

  mvc@702da000 {
   status = "okay";
  };

  mvc@702da200 {
   status = "okay";
  };

  spdif@702d6000 {
   status = "okay";
  };
  iqc@702de000 {
   timestamp-enable = <0>;
   data-offset = <1>;
   status = "okay";
  };
  iqc@702de200 {
   timestamp-enable = <0>;
   data-offset = <1>;
                        status = "okay";
                };

  ope@702d8000 {
   status = "okay";
  };

  ope@702d8400 {
   status = "okay";
  };
 };

 agic-controller {
  compatible = "nvidia,tegra210-agic";
  interrupt-controller;
  no-gic-extension;
  not-per-cpu;
  reg = <0x0 0x702f9000 0x0 0x2000>,
        <0x0 0x702fa000 0x0 0x2000>;
  interrupts = <0 102 0xf04>;
  status = "disabled";
 };

 hda@70030000 {
  compatible = "nvidia,tegra30-hda";
  reg = <0x0 0x70030000 0x0 0x10000>;
  interrupts = <0 81 0x04>;
  status = "disabled";
 };

 adsp_audio {
  status = "disabled";
 };

 adsp {
  compatible = "nvidia,tegra210-adsp";
  status = "disabled";
 };

 spdif_dit0: spdif-dit.0@0 {
  compatible = "linux,spdif-dit";
  reg = <0x0 0x0 0x0 0x0>;
  status = "disabled";
 };

 spdif_dit1: spdif-dit.1@1 {
  compatible = "linux,spdif-dit";
  reg = <0x0 0x1 0x0 0x0>;
  status = "disabled";
 };

 spdif_dit2: spdif-dit.2@2 {
  compatible = "linux,spdif-dit";
  reg = <0x0 0x2 0x0 0x0>;
  status = "disabled";
 };

 spdif_dit3: spdif-dit.3@3 {
  compatible = "linux,spdif-dit";
  reg = <0x0 0x03 0x0 0x0>;
  status = "disabled";
 };

 sound {
  compatible = "nvidia,tegra-audio-grenada";
  status = "disabled";
  nvidia,model = "tegra-snd-grenada";
  nvidia,num-amx = <2>;
  nvidia,num-adx = <2>;
  nvidia,amx-slot-size = <32 32>;
  nvidia,adx-slot-size = <32 32>;
  nvidia,num-codec-link = <7>;
  nvidia,amx-slot-map = <

   ((0 << 16) | (0 << 8) | 0)
   ((0 << 16) | (0 << 8) | 0)
   ((0 << 16) | (1 << 8) | 0)
   ((0 << 16) | (1 << 8) | 1)
   ((0 << 16) | (0 << 8) | 0)
   ((0 << 16) | (0 << 8) | 0)
   ((0 << 16) | (2 << 8) | 0)
   ((0 << 16) | (2 << 8) | 1)

   ((0 << 16) | (0 << 8) | 0)
   ((0 << 16) | (0 << 8) | 0)
   ((1 << 16) | (1 << 8) | 0)
   ((1 << 16) | (1 << 8) | 1)
   ((0 << 16) | (0 << 8) | 0)
   ((0 << 16) | (0 << 8) | 0)
   ((1 << 16) | (2 << 8) | 0)
   ((1 << 16) | (2 << 8) | 1)

   ((0 << 16) | (0 << 8) | 0)
   ((0 << 16) | (0 << 8) | 0)
   ((2 << 16) | (1 << 8) | 0)
   ((2 << 16) | (1 << 8) | 1)
   ((0 << 16) | (0 << 8) | 0)
   ((0 << 16) | (0 << 8) | 0)
   ((2 << 16) | (2 << 8) | 0)
   ((2 << 16) | (2 << 8) | 1)

   ((0 << 16) | (0 << 8) | 0)
   ((0 << 16) | (0 << 8) | 0)
   ((3 << 16) | (1 << 8) | 0)
   ((3 << 16) | (1 << 8) | 1)
   ((0 << 16) | (0 << 8) | 0)
   ((0 << 16) | (0 << 8) | 0)
   ((3 << 16) | (2 << 8) | 0)
   ((3 << 16) | (2 << 8) | 1)>;
  nvidia,adx-slot-map = <

   ((0 << 16) | (0 << 8) | 0)
   ((0 << 16) | (0 << 8) | 0)
   ((0 << 16) | (1 << 8) | 0)
   ((0 << 16) | (1 << 8) | 1)
   ((0 << 16) | (0 << 8) | 0)
   ((0 << 16) | (0 << 8) | 0)
   ((0 << 16) | (2 << 8) | 0)
   ((0 << 16) | (2 << 8) | 1)

   ((0 << 16) | (0 << 8) | 0)
   ((0 << 16) | (0 << 8) | 0)
   ((1 << 16) | (1 << 8) | 0)
   ((1 << 16) | (1 << 8) | 1)
   ((0 << 16) | (0 << 8) | 0)
   ((0 << 16) | (0 << 8) | 0)
   ((1 << 16) | (2 << 8) | 0)
   ((1 << 16) | (2 << 8) | 1)

   ((0 << 16) | (0 << 8) | 0)
   ((0 << 16) | (0 << 8) | 0)
   ((2 << 16) | (1 << 8) | 0)
   ((2 << 16) | (1 << 8) | 1)
   ((0 << 16) | (0 << 8) | 0)
   ((0 << 16) | (0 << 8) | 0)
   ((2 << 16) | (2 << 8) | 0)
   ((2 << 16) | (2 << 8) | 1)

   ((0 << 16) | (0 << 8) | 0)
   ((0 << 16) | (0 << 8) | 0)
   ((3 << 16) | (1 << 8) | 0)
   ((3 << 16) | (1 << 8) | 1)
   ((0 << 16) | (0 << 8) | 0)
   ((0 << 16) | (0 << 8) | 0)
   ((3 << 16) | (2 << 8) | 0)
   ((3 << 16) | (2 << 8) | 1)>;

  nvidia,audio-routing =
   "x Headphone", "x OUT",
   "y Headphone", "y OUT",
   "z Headphone", "z OUT",
   "s Headphone", "s OUT",
   "x IN", "x Mic",
   "y IN", "y Mic",
   "z IN", "z Mic",
   "s IN", "s Mic";
  nvidia,xbar = <&tegra_axbar>;

  nvidia,dai-link-1 {
   link-name = "spdif-dit-0";
   cpu-dai = <&tegra_i2s1>;
   codec-dai = <&spdif_dit0>;
   cpu-dai-name = "I2S1";
   codec-dai-name = "dit-hifi";
   tx-mask = <0xFF>;
   rx-mask = <0xFF>;
   format = "i2s";
   bitclock-slave;
   frame-slave;
   bitclock-noninversion;
   frame-noninversion;
   bit-format = "s16_le";
   bclk_ratio = <0>;
   srate = <48000>;
   num-channel = <2>;
   name-prefix = "x";
  };
  nvidia,dai-link-2 {
   link-name = "spdif-dit-1";
   cpu-dai = <&tegra_i2s3>;
   codec-dai = <&spdif_dit1>;
   cpu-dai-name = "I2S3";
   codec-dai-name = "dit-hifi";
   tx-mask = <0xFF>;
   rx-mask = <0xFF>;
   format = "dsp_a";
   bitclock-slave;
   frame-slave;
   bitclock-noninversion;
   frame-noninversion;
   bit-format = "s32_le";
   bclk_ratio = <0>;
   srate = <48000>;
   num-channel = <8>;
   name-prefix = "y";
  };
  nvidia,dai-link-3 {
   link-name = "spdif-dit-2";
   cpu-dai = <&tegra_i2s5>;
   codec-dai = <&spdif_dit2>;
   cpu-dai-name = "I2S5";
   codec-dai-name = "dit-hifi";
   tx-mask = <0xFF>;
   rx-mask = <0xFF>;
   format = "i2s";
   bitclock-slave;
   frame-slave;
   bitclock-noninversion;
   frame-noninversion;
   bit-format = "s16_le";
   bclk_ratio = <0>;
   srate = <48000>;
   num-channel = <2>;
   name-prefix = "z";
  };
  nvidia,dai-link-4 {
   link-name = "spdif-dit-3";
   cpu-dai = <&tegra_spdif>;
   codec-dai = <&spdif_dit3>;
   cpu-dai-name = "SPDIF1-1";
   codec-dai-name = "dit-hifi";
   format = "i2s";
   bit-format = "s16_le";
   srate = <48000>;
   num-channel = <2>;
   name-prefix = "s";
  };
  nvidia,dai-link-5 {
   link-name = "spdif-dit-4";
   cpu-dai = <&tegra_dmic1>;
   codec-dai = <&spdif_dit0>;
   cpu-dai-name = "DMIC1";
   codec-dai-name = "dit-hifi";
   format = "i2s";
   bit-format = "s16_le";
   srate = <48000>;
   num-channel = <2>;
   name-prefix = "dmic-x";
  };
  nvidia,dai-link-6 {
   link-name = "spdif-dit-5";
   cpu-dai = <&tegra_dmic2>;
   codec-dai = <&spdif_dit1>;
   cpu-dai-name = "DMIC2";
   codec-dai-name = "dit-hifi";
   format = "i2s";
   bit-format = "s16_le";
   srate = <48000>;
   num-channel = <2>;
   name-prefix = "dmic-y";
  };
  nvidia,dai-link-7 {
   link-name = "spdif-dit-6";
   cpu-dai = <&tegra_dmic3>;
   codec-dai = <&spdif_dit2>;
   cpu-dai-name = "DMIC3";
   codec-dai-name = "dit-hifi";
   format = "i2s";
   bit-format = "s16_le";
   srate = <48000>;
   num-channel = <2>;
   name-prefix = "dmic-z";
  };
 };

 pcie-controller {
  status = "disabled";

  pci@1,0 {
   status = "disabled";
  };

  pci@2,0 {
   status = "disabled";
  };
 };

 sdhci@700b0600 {
  tap-delay = <4>;
  trim-delay = <8>;
  dqs-trim-delay = <17>;
  mmc-ocr-mask = <0>;
  max-clk-limit = <200000000>;
  uhs-mask = <0x0>;
  bus-width = <8>;
  id = <3>;
  built-in;
  calib_1v8_offsets = <0x0707>;
  status = "okay";
 };

 sata@70020000 {
  status = "disabled";
  nvidia,enable-sata-port;
 };

 sdhci@700b0400 {
  tap-delay = <1>;
  trim-delay = <3>;
  max-clk-limit = <204000000>;
  ddr-clk-limit = <48000000>;
  bus-width = <4>;
  id = <2>;
  calib_3v3_offsets = <0x0101>;
  calib_1v8_offsets = <0x0202>;
  cd-gpios = <&gpio 202 0>;
  wp-gpios = <&gpio 203 0>;
  mmc-ocr-mask = <3>;
  status = "okay";
 };
 sdhci@700b0200 {
  tap-delay = <4>;
  trim-delay = <8>;
  dqs-trim-delay = <17>;
  mmc-ocr-mask = <0>;
  max-clk-limit = <200000000>;
  uhs-mask = <0x0>;
  bus-width = <8>;
  id = <1>;
  built-in;
  calib_1v8_offsets = <0x0707>;
  status = "okay";
 };

 udc@7d000000 {
  status = "okay";
 };


 xusb_pad_ctl: xusb_padctl {
  nvidia,ss_portmap = <0x3210>;
  nvidia,lane_owner = <0x8456>;
  status = "okay";
 };

 xusb@70090000 {


  nvidia,gpio_ss1_sata = <0>;
  nvidia,ulpicap = <0>;
  nvidia,portmap = <0xe0e>;
  nvidia,supply_utmi_vbuses = "usb_vbus0", "usb_vbus1", "usb_vbus2";
  nvidia,supply_s3p3v = "hvdd_usb";
  nvidia,supply_s1p8v = "avdd_pll_utmip";
  nvidia,supply_vddio_hsic = "vddio_hsic";
  nvidia,supply_s1p05v = "avddio_usb";

  nvidia,hsic0 = /bits/8 <0x1 0x1 0x8 0xa 0 0 1 0x22 0>;
  nvidia,common_padctl = <&xusb_pad_ctl>;
  status = "okay";
 };

 xudc@700D0000 {
  nvidia,common_padctl = <&xusb_pad_ctl>;
  status = "okay";
 };

 gpu-dvfs-rework {
  status = "disabled";
 };

 tegra_cec {
  compatible = "nvidia,tegra210-cec";
  status = "disabled";
 };

 ptm {
  status = "disabled";
 };

 asim {
  compatible = "nvidia,tegra210-asim";
  reg = < 0x0 0x538f0000 0x0 0x1000 >;
 };

 ethernet@0x4e000000 {
  compatible = "smsc,lan9115";
  reg = < 0x0 0x4e000000 0x0 0x00010000 >;
  interrupts = < 0 48 0x4 >;
  reg-io-width = <4>;
  smsc,irq-active-high;
  smsc,irq-push-pull;
 };

 pwm_regulators {
  gpu_ovr_reg: pwm-regulator@1 {
   /delete-property/ enable-gpio;
  };
 };
};
